## 11_line_detect/Kconfig
```kconfig
mainmenu "HTTP video server application"

# Конфиг для опциональной настройки Zephyr проекта.
#----------------------------------------------------------
config STM32_TRUE
	bool "Lets system know that a board STM32 has been selected."
	default n

config ESP32_TRUE
	bool "Lets system know that a board ESP32 has been selected."
	default n

config DISPLAY_TRUE
	bool "Lets system know that you need to use display."
	default n

config SERVER_TRUE
	bool "Lets system know that you need to use web server."
	default n

# Конфиг для видеоподсистемы Zephyr.
#----------------------------------------------------------
config VIDEO_SOURCE_CROP_LEFT
	int "Crop area left value"
	default 0
	help
	   Left value of the crop area within the video source.

config VIDEO_SOURCE_CROP_TOP
	int "Crop area top value"
	default 0
	help
	   Top value of the crop area within the video source.

config VIDEO_SOURCE_CROP_WIDTH
	int "Crop area width value"
	default 0
	help
	   Width value of the crop area within the video source.
	   If set to 0, the crop is not applied.

config VIDEO_SOURCE_CROP_HEIGHT
	int "Crop area height value"
	default 0
	help
	   Height value of the crop area within the video source.
	   If set to 0, the crop is not applied.

config VIDEO_FRAME_HEIGHT
	int "Height of the video frame"
	default 0
	help
	  Height of the video frame. If set to 0, the default height is used.

config VIDEO_FRAME_WIDTH
	int "Width of the video frame"
	default 0
	help
	  Width of the video frame. If set to 0, the default width is used.

config VIDEO_PIXEL_FORMAT
	string "Pixel format of the video frame"
	help
	  Pixel format of the video frame. If not set, the default pixel format is used.

config VIDEO_CTRL_HFLIP
	bool "Mirror the video frame horizontally"
	help
	  If set, mirror the video frame horizontally

config VIDEO_CTRL_VFLIP
	bool "Mirror the video frame vertically"
	help
	  If set, mirror the video frame vertically

config VIDEO_SHELL_AND_CAPTURE
	bool "Capture video even if the video shell is enabled"
	depends on VIDEO_SHELL
	default n
	help
	  If set, the video capture is enabled even if the video shell is also enabled.

config SCREEN_WIDTH_TO_CROSS_DIM
	int "Screen width to cross horizontal/vertical dimension ratio"
	default 25

# Конфиг для сетевой подсистемы Zephyr.
#----------------------------------------------------------
config NET_VIDEO_HTTP_SERVICE
	bool "Enable http service"
	default y

config NET_VIDEO_HTTP_SERVER_SERVICE_PORT
	int "Port number for http service"
	default 80
	depends on NET_VIDEO_HTTP_SERVICE

config NET_SAMPLE_HTTPS_SERVICE
	bool "Enable https service"
	depends on NET_SOCKETS_SOCKOPT_TLS || TLS_CREDENTIALS
	select PSA_CRYPTO

if NET_SAMPLE_HTTPS_SERVICE

config NET_SAMPLE_HTTPS_SERVER_SERVICE_PORT
	int "Port number for https service"
	default 443
	depends on NET_SAMPLE_HTTPS_SERVICE

config NET_SAMPLE_HTTPS_USE_ALPN
	bool "Allow HTTP2 connectivity with web browsers by using ALPN"
	select MBEDTLS_SSL_ALPN
	select HTTP_SERVER_TLS_USE_ALPN
	help
	  Web browsers only use HTTP/2 over HTTPS, and use ALPN to determine if a
	  server supports HTTP/2. If this option is enabled, web browsers can use
	  HTTP/2 to communicate with the server. However web browsers are stricter
	  with security when using HTTP/2, at a minimum you will need to add the CA
	  certificate used to sign the server certificate into your web browser's
	  trusted authorities. Otherwise the connection can fail with a security
	  error, without giving an option to ignore this and proceed anyway.

endif # NET_SAMPLE_HTTPS_SERVICE

config NET_SAMPLE_PSK_HEADER_FILE
	string "Header file containing PSK"
	default "dummy_psk.h"
	depends on MBEDTLS_KEY_EXCHANGE_PSK_ENABLED
	help
	  Name of a header file containing a
	  pre-shared key.

config NET_VIDEO_WEBSOCKET_SERVICE
	bool "Enable websocket service"
	default y if HTTP_SERVER_WEBSOCKET

config NET_VIDEO_NUM_WEBSOCKET_HANDLERS
	int "How many websocket connections to serve at the same time"
	depends on NET_VIDEO_WEBSOCKET_SERVICE
	default 1
	help
	  Each websocket connection is served by a thread which needs
	  memory. Only increase the value here if really needed.

config NET_VIDEO_WEBSOCKET_FRAME_INTERVAL
	int "Interval in milliseconds to send network video frame over websocket"
	depends on NET_VIDEO_WEBSOCKET_SERVICE
	default 100
	help
	  This interval controls how often the video frame shown on the web page will be updated.



source "samples/net/common/Kconfig"
source "Kconfig.zephyr"
```
