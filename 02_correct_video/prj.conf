## prj.conf
```kconfig
# Включает кастомный сервис трансляции видео по WebSocket, определенный в Kconfig-файле проекта.
CONFIG_NET_VIDEO_WEBSOCKET_SERVICE=y

# Позволяет Zephyr в рантайме мониторить реальное использование стека и точно определять, если какому-то потоку начинает не хватать памяти.
CONFIG_INIT_STACKS=y
# Устанавливает размер стека главного потока main() в 4 КБ.
CONFIG_MAIN_STACK_SIZE=4096
# Размер стека системной рабочей очереди для отложенного выполнения задач.
CONFIG_SYSTEM_WORKQUEUE_STACK_SIZE=2048

# Включает интерактивную командную строку, позволяет подключаться к устройству через UART или USB-консоль и вводить команды для отладки.
CONFIG_SHELL=y
# Активирует глобальную систему логирования, которая позволяет выводить отладочные сообщения в консоль.
CONFIG_LOG=y

# Включают генераторы случайных чисел. 
# Необходимы криптографическим подсистемам и сетевому стеку для генерации случайных идентификаторов сессий и портов.
CONFIG_ENTROPY_GENERATOR=y
CONFIG_TEST_RANDOM_GENERATOR=y

# Включает встроенную в Zephyr библиотеку для работы с JSON.
CONFIG_JSON_LIBRARY=y

# Позволяет устройству выступать в роли HTTP-клиента
CONFIG_HTTP_CLIENT=y
# Активирует встроенный легковесный HTTP-сервер Zephyr для отдачи веб-страниц.
CONFIG_HTTP_SERVER=y
# Добавляет поддержку протокола WebSocket для HTTP-сервера.
CONFIG_HTTP_SERVER_WEBSOCKET=y

# Включает официальный HTTP-парсер (на базе node.js http-parser) и отдельную опцию разбора URL.
# Позволяет серверу корректно парсить входящие HTTP-запросы, заголовки и пути.
CONFIG_HTTP_PARSER_URL=y
CONFIG_HTTP_PARSER=y

# Networking config
# Главный переключатель сетевого стека Zephyr.
CONFIG_NETWORKING=y
# Включает поддержку протокола IPv4.
CONFIG_NET_IPV4=y
# Отключает IPv6 для экономии оперативной и флеш-памяти микроконтроллера.
CONFIG_NET_IPV6=n
# Включает транспортный протокол TCP (база для HTTP и WebSockets).
CONFIG_NET_TCP=y
# Включает POSIX-совместимый API сокетов (socket(), bind(), listen()), упрощающий написание сетевого кода.
CONFIG_NET_SOCKETS=y
# Менеджер сетевых подключений для координации работы интерфейсов.
CONFIG_NET_CONNECTION_MANAGER=y
# Добавляет сетевые команды в консоль (например, net iface, ping).
CONFIG_NET_SHELL=y

# Включает уровень канального доступа (Layer 2) для Ethernet-контроллеров.
CONFIG_NET_L2_ETHERNET=y
# Включает клиент DHCPv4, позволяющий устройству автоматически получать IP-адрес от роутера.
CONFIG_NET_DHCPV4=y
# Включает клиент разрешения доменных имен (DNS).
CONFIG_DNS_RESOLVER=y

# Настройка пулов памяти под сетевые пакеты (net_pkt) и блоки буферов (net_buf).
CONFIG_NET_PKT_RX_COUNT=16
CONFIG_NET_PKT_TX_COUNT=16
CONFIG_NET_BUF_RX_COUNT=128
CONFIG_NET_BUF_TX_COUNT=128
CONFIG_NET_CONTEXT_NET_PKT_POOL=y

# Network address config
# Отключение статической предконфигурации сетевых адресов.
# Поскольку выше включен DHCPv4, ручное жесткое задание IP-адресов отключено. Устройство получает параметры динамически.
CONFIG_NET_CONFIG_SETTINGS=n
CONFIG_NET_CONFIG_NEED_IPV4=n
CONFIG_NET_CONFIG_NEED_IPV6=n
# CONFIG_NET_CONFIG_MY_IPV4_ADDR="192.0.2.1"
# CONFIG_NET_CONFIG_PEER_IPV4_ADDR="192.0.2.2"
# CONFIG_NET_CONFIG_MY_IPV4_GW="192.0.2.2"
# CONFIG_NET_CONFIG_MY_IPV6_ADDR="2001:db8::1"
# CONFIG_NET_CONFIG_PEER_IPV6_ADDR="2001:db8::2"

# Убирает задержку в состоянии TIME_WAIT для закрывающихся TCP-соединений.
CONFIG_NET_TCP_TIME_WAIT_DELAY=0

# Ограничение максимального числа одновременных сетевых контекстов и TCP-соединений до 10.
# Предотвращает перерасход оперативной памяти
CONFIG_NET_MAX_CONTEXTS=10
CONFIG_NET_MAX_CONN=10

# Подсистема управления сетью и генерации событий.
# Позволяет коду приложения отслеживать системные события (например, «линк поднят», «IP получен») через колбэки.
CONFIG_NET_MGMT=y
CONFIG_NET_MGMT_EVENT=y


# General config
# Требует подключения полной стандартной библиотеки языка C (а не урезанной мини-версии вроде picolibc).
# Необходима для корректной работы сторонних библиотек и сложных алгоритмов обработки данных.
CONFIG_REQUIRES_FULL_LIBC=y
# Подсистема ввода (кнопки, датчики).
CONFIG_INPUT=y
# Включает шину SPI (используется для дисплеев или камер).
CONFIG_SPI=y
# Базовый контроль портов ввода-вывода (управление пинами).
CONFIG_GPIO=y
# CONFIG_LED=y

# Подсистема захвата и обработки видео (работа с камерами, фреймбуферами).
CONFIG_VIDEO=y
# Подсистема вывода графики на экран дисплея.
CONFIG_DISPLAY=y
# Включает UART/USB консоль для управления устройствами.
CONFIG_DEVICE_SHELL=y

# Включает быстрый вывод сообщений ядра в консоль.
CONFIG_PRINTK=y
# Включает поддержку вывода чисел с плавающей точкой (float/double) в функциях форматированного вывода (printk/printf).
CONFIG_CBPRINTF_FP_SUPPORT=y
# Гарантирует поддержку вывода float на уровне глобального форматирования.
CONFIG_REQUIRES_FLOAT_PRINTF=y

# Подключить API обёртку для POSIX (Portable Operating System Interface) стандарта.
CONFIG_POSIX_API=y
# Event File Descriptors - включает поддержку механизма POSIX-совместимого способа уведомления о событиях через файловые дескриптор.
CONFIG_EVENTFD=y

# ZVFS (Zephyr Virtual Filesystem) - мост между Zephyr и стандартами POSIX/C для работы с файлами, сокетами и устройствами.
# Значение 32 означает, что можно одновременно опрашивать до 32 сокетов или других файловых дескрипторов. 
CONFIG_ZVFS_POLL_MAX=32
# Максимальное количество событий для сетевых подсистем (HTTP-сервер, CoAP-сервер, LwM2M, PTP, SSH, socket service) .
CONFIG_ZVFS_EVENTFD_MAX=4
# Дополнительное количество слотов для открытых файловых дескрипторов для обработки одновременных клиентских соединений.
CONFIG_ZVFS_OPEN_ADD_SIZE_NET_SAMPLE=24


# Включение алгоритма хеширования SHA-1 в криптографическом бэкенде mbedTLS (через стандартизированный API PSA Crypto).
# Протокол WebSocket на этапе рукопожатия (Sec-WebSocket-Accept) требует обязательного вычисления хеша SHA-1 от специального ключа клиента.
CONFIG_PSA_WANT_ALG_SHA_1=y
CONFIG_MBEDTLS_SHA1=y



# ==========================================================================
# Включает подсистему дисплея Zephyr, именно через эту подсистему LVGL получает доступ к дисплею.
CONFIG_DISPLAY=y
# В отложенном режиме сообщения в подсистеме логирования не выводятся немедленно, а помещаются в буфер и обрабатываются фоновым потоком.
CONFIG_LOG_MODE_DEFERRED=y
# Задаёт размер системной кучи ядра Zephyr в байтах. Драйверы (дисплея и input) используют динамическое выделение памяти под буферы.
CONFIG_HEAP_MEM_POOL_SIZE=46144

# Включает драйвер резистивного тачскрина XPT2046. Драйвер работает через шину SPI и создаёт устройство ввода в подсистеме input.
CONFIG_INPUT_XPT2046=y
# Включает поддержку шины SPI на уровне драйверов Zephyr. SPI необходим для работы дисплея и сенсорной панели.
CONFIG_SPI=y
# Включает подсистему GPIO Zephyr. Нужна для управления пинами (сброс дисплея, прерывание тачскрина, подсветка)
CONFIG_GPIO=y

# Устанавливает уровень логирования для подсистемы input на DBG (debug). Это самый подробный уровень - выводятся все отладочные сообщения.
# CONFIG_INPUT_LOG_LEVEL_DBG=y

# Включает графическую библиотеку LVGL как модуль Zephyr. 
CONFIG_LVGL=y
# Задаёт глубину цвета LVGL - 16 бит на пиксель, формат RGB565 на ST7796.
CONFIG_LV_COLOR_DEPTH_16=y

# Включает подсистему ввода Zephyr. Это обязательное условие для работы любого драйвера ввода (включая XPT2046) и для связки с LVGL.
CONFIG_INPUT=y
# Включает мост между подсистемой input Zephyr и LVGL. Этот код слушает события от устройства ввода и преобразует их в lv_indev_data_t.
CONFIG_LV_Z_POINTER_INPUT=y

# Включает виджет slider (ползунок) в сборке LVGL.
CONFIG_LV_USE_SLIDER=y
# Модуль LVGL при инициализации находит устройство, на которое указывает zephyr,touch, и подписывается на его события. 
CONFIG_LV_Z_POINTER_FROM_CHOSEN_TOUCH=y

# Задаёт размер кучи, выделенной специально для LVGL, в байтах.
CONFIG_LV_Z_MEM_POOL_SIZE=16384
# Включает встроенную систему логирования LVGL.
CONFIG_LV_USE_LOG=y
# Сообщает интеграционному слою LVGL/Zephyr, сколько бит на пиксель используется в буферах дисплея.
CONFIG_LV_Z_BITS_PER_PIXEL=16
# Выполняет байтовый своп для 16-битных цветов RGB565. Без свопа вы увидите инвертированные цвета.
CONFIG_LV_COLOR_16_SWAP=y


# Включает библиотеку libmpix — легковесную библиотеку для обработки пиксельных данных на микроконтроллерах.
CONFIG_MPIX=y
```

## boards/mini_stm32h743.conf
```kconfig
# ---------------------------------------------------------------------------------------------------------------------------------------------
# west build -p always -b mini_stm32h743 -- -DDTC_OVERLAY_FILE=boards/mini_stm32h743.overlay -DEXTRA_CONF_FILE=boards/mini_stm32h743.conf
# ---------------------------------------------------------------------------------------------------------------------------------------------

# Указываем что платформой для проекта выбрана плата STM32.
CONFIG_STM32_TRUE=y
# Включаем в проект сервер.
CONFIG_SERVER_TRUE=y
# Включаем в проект дисплей.
CONFIG_DISPLAY_TRUE=y

# Размер heap памяти для выделения видео буферов (в байтах)
CONFIG_VIDEO_BUFFER_POOL_HEAP_SIZE=80000
# Размер кадра захваченого камерой.
CONFIG_VIDEO_FRAME_HEIGHT=120
CONFIG_VIDEO_FRAME_WIDTH=160
# Устанавливает формат пикселей RGBP (соответствует стандарту RGB565 — 16 бит на пиксель).
CONFIG_VIDEO_PIXEL_FORMAT="RGBP"
# Vertical Flip (зеркальное отражение по вертикали)
CONFIG_VIDEO_CTRL_VFLIP=n
# Horizontal Flip (зеркальное отражение по горизонтали).
CONFIG_VIDEO_CTRL_HFLIP=n

# Включает встроенный в Zephyr драйвер для популярного аппаратного Ethernet-контроллера W5500.
CONFIG_ETH_W5500=y
# Устанавливает тайм-аут операций обмена с чипом W5500 (в миллисекундах — 1000 мс / 1 секунда).
CONFIG_ETH_W5500_TIMEOUT=1000

# Принудительная задержка старта системы (Boot Delay) на 5000 миллисекунд (5 секунд).
CONFIG_BOOT_DELAY=5000

# Включает драйверы последовательных интерфейсов ввода-вывода (Serial).
CONFIG_SERIAL=y
# Активирует общую подсистему системной консоли Zephyr.
CONFIG_CONSOLE=y
# Направляет вывод консоли через последовательный интерфейс
CONFIG_UART_CONSOLE=y

# Включает управление линиями связи последовательного порта (UART Line Control).
CONFIG_UART_LINE_CTRL=y

# Выделяет 2 КБ (2048 байт) под кольцевой буфер логирования.
CONFIG_LOG_BUFFER_SIZE=2048
# Задает уровень детализации логов для подсистемы дисплея строго на уровень Errors (только ошибки).
CONFIG_DISPLAY_LOG_LEVEL_ERR=y
```

## src/main.c
```c
/********************************************
    Подготовил: Степанюк Денис Борисович
********************************************/

// Стандартный ввод-вывод для логирования
#include <stdio.h>
// Макросы для форматирования целых чисел фиксированного размера.
#include <inttypes.h>
// Основные функции RTOS: потоки, таймеры, семафоры
#include <zephyr/kernel.h>
// Системные утилиты: BIT(), ARRAY_SIZE(), STRINGIFY(), и т.д.
#include "zephyr/sys/util.h"
// Парсинг и генерация JSON.
#include <zephyr/data/json.h>
// Дополнительные макросы (BIT_MASK(n) — маска из n единичных битов. BIT_MASK(2) = 0b11 = 3 (используется для проверки результата json_obj_parse)).
#include <zephyr/sys/util_macro.h>
// Работа с кэшем процессора.
#include <zephyr/cache.h>
// Используется для DEVICE_DT_GET_ANY() — получить указатель на устройство из Device Tree.
#include <zephyr/device.h>
// API видеоподсистемы: video_dequeue, video_enqueue, video_stream_start
#include <zephyr/drivers/video.h>
// Элементы управления камеры (яркость, экспозиция и т.д.)
#include <zephyr/drivers/video-controls.h>
// Логика видеоподсистемы.
#include "video.h"
// Библиотека для обработки пиксельных данных.
#include <mpix/image.h>
// Поток выделенный под пользовательский интерфейс на базе LVGL.
#include "thread_ui.h"

// Регистрируем модуль логирования.
#include <zephyr/logging/log.h>
LOG_MODULE_REGISTER(MAIN_LOG, LOG_LEVEL_DBG);

// Код компилируется только при включённом через конфиг дисплее в проект.
#if defined(CONFIG_DISPLAY_TRUE)
    // Драйвер дисплея.
    #include <zephyr/drivers/display.h>
    // Логика работы с дисплеем.
    #include "display.h"
#endif /* CONFIG_DISPLAY_TRUE */  

// Код компилируется только при включённом через конфиг сервере в проект.
#if defined(CONFIG_SERVER_TRUE)
    // Логика WebSocket-сервера.
    #include "server.h"
    /* Высокоуровневая подсистема HTTP-сервера для Zephyr
    - Принимает TCP соединения
    - Парсит HTTP запросы
    - Маршрутизирует по URL → вызывает нужный handler
    - Выполняет WebSocket Upgrade (SHA1, Base64 — скрыто внутри)
    - Управляет потоками клиентов*/
    #include <zephyr/net/http/server.h>
    // Макросы для объявления HTTP/HTTPS сервисов и ресурсов:
    #include <zephyr/net/http/service.h>
    // Работа с IP-адресами и вспомогательными функциями сетевого стека. Нужен для типов адресов (sockaddr_in и т.д.) которые использует сервис.
    #include <zephyr/net/net_ip.h>
    // BSD Sockets API (zsock_*). Используется внутри WebSocket-колбэков для низкоуровневой работы с сокетами (websocket_send_msg и др.).
    #include <zephyr/net/socket.h>
    // Инициализация сетевого стека через конфиг. Используется только при CONFIG_USB_DEVICE_STACK_NEXT.
    #include <zephyr/net/net_config.h>

    // Код компилируется при условии что платформой для проекта выбрана плата STM32.
    #if defined(CONFIG_STM32_TRUE)
        // Логика подключения к интернету по dhcp.
        #include "dhcp.h"
    #endif /* CONFIG_STM32_TRUE */

    // Код компилируется при условии что платформой для проекта выбрана плата ESP32.
    #if defined(CONFIG_ESP32_TRUE)
        // Логика подключения к интернету по wifi.
        #include "wifi.h"

        /* Параметры WiFi */
        #define WIFI_SSID "NAME"
        #define WIFI_PSK "PASSWORD"

    #endif /* CONFIG_ESP32_TRUE */

    /* Сжатая gzip-версия главной HTML страницы. Файл index.html во время сборки преобразуется в массив байтов и вшивается непосредственно в прошивку.*/
    static const uint8_t index_html_gz[] = {
    #include "index.html.gz.inc"
    };

    /* Описание статического HTTP ресурса. При запросе: GET / 
    HTTP Server автоматически отправит содержимое index_html_gz без вызова пользовательского обработчика.*/
    static struct http_resource_detail_static index_html_gz_resource_detail = {
        .common = {
                .type = HTTP_RESOURCE_TYPE_STATIC, // Тип ресурса: статический файл. HTTP Server сам отправит данные без вызова колбэка.
                .bitmask_of_supported_http_methods = BIT(HTTP_GET), // Поддерживаемые HTTP-методы — битовая маска.
                .content_encoding = "gzip", // HTTP заголовок Content-Encoding: gzip. Говорит браузеру что данные сжаты gzip → браузер распакует.
                .content_type = "text/html", // HTTP заголовок Content-Type: text/html. Браузер будет рендерить как HTML.
            },
        .static_data = index_html_gz, // Указатель на данные (наш gzip-массив).
        .static_data_len = sizeof(index_html_gz), // Размер данных в байтах — сервер отправит ровно столько байт.
    };

    // Блок компилируется только при CONFIG_NET_VIDEO_WEBSOCKET_SERVICE=y в prj.conf. Это позволяет собирать проект без WebSocket если он не нужен.
    #if defined(CONFIG_NET_VIDEO_WEBSOCKET_SERVICE)

    /* Буфер WebSocket подсистемы. Используется HTTP Server во время обработки входящих
    WebSocket сообщений. Видеокадры через этот буфер не передаются.*/
    static uint8_t ws_net_video_buffer[128];

    /* Описание WebSocket ресурса.
    После подключения клиента вызывается: ws_net_video_setup() которая запускает периодическую отправку видеокадров.*/
    struct http_resource_detail_websocket ws_net_video_resource_detail = {
        .common = {
                .type = HTTP_RESOURCE_TYPE_WEBSOCKET, // Тип ресурса: WebSocket.
                .bitmask_of_supported_http_methods = BIT(HTTP_GET), // WS-апгрейд начинается с GET-запроса.
            },
        .cb = ws_net_video_setup, // Колбэк: запускает поток, шлющий видеокадры клиенту.
        .data_buffer = ws_net_video_buffer, // Буфер под входящие WS-сообщения.
        .data_buffer_len = sizeof(ws_net_video_buffer), // Размер этого буфера (128 байт).
        .user_data = NULL, // Пользовательские данные не нужны.
    };

    #endif /* CONFIG_NET_VIDEO_WEBSOCKET_SERVICE */

    /* Декларативная регистрация сервера. С помощью макросов собираем "дерево" веб-сервера. 
       Во время компиляции Zephyr сложит их в специальную секцию памяти, и сервер запустится автоматически.*/
    #if defined(CONFIG_NET_VIDEO_HTTP_SERVICE)
    // TCP порт для HTTP сервера. По умолчанию CONFIG_NET_VIDEO_HTTP_SERVER_SERVICE_PORT=80.
    static uint16_t video_http_service_port = CONFIG_NET_VIDEO_HTTP_SERVER_SERVICE_PORT;

    /* Регистрация HTTP сервиса. После вызова http_server_start() сервер автоматически найдёт
    этот сервис и начнёт принимать подключения. */
    HTTP_SERVICE_DEFINE(video_http_service, // Имя сервиса (уникальный идентификатор)
                        NULL, // IP-адрес для привязки (NULL = INADDR_ANY)
                        &video_http_service_port, // Указатель на порт.
                        CONFIG_HTTP_SERVER_MAX_CLIENTS, // Макс. одновременных клиентов из prj.conf.
                        10,  // Backlog (очередь ожидающих соединений)
                        NULL, // Колбэк при старте (не нужен)
                        NULL, // Колбэк при остановке (не нужен)
                        NULL); // Пользовательские данные

    /*  Главная HTML страница.
        HTTP_RESOURCE_DEFINE — макрос, привязывающий URL к ресурсу (статическому, динамическому или WebSocket).*/
    HTTP_RESOURCE_DEFINE(index_html_gz_resource, video_http_service, "/", &index_html_gz_resource_detail);

    #if defined(CONFIG_NET_VIDEO_WEBSOCKET_SERVICE)
    // WebSocket-ресурсы регистрируются точно так же: URL может быть любым, не конфликтующим.
    HTTP_RESOURCE_DEFINE(ws_net_video_resource, video_http_service, "/", &ws_net_video_resource_detail);
    #endif /* CONFIG_NET_VIDEO_WEBSOCKET_SERVICE */
    #endif /* CONFIG_NET_VIDEO_HTTP_SERVICE */

#endif /* CONFIG_SERVER_TRUE */

// Cтатический массив байтов, в который главный цикл main() копирует уже обработанный кадр.
// Из него кадр затем: копируется в shared_frame_buf для отправки по WebSocket и выводится на дисплей через display_vbuf.
#if defined(CONFIG_ESP32_TRUE)
    // Для ESP32 буфер следует разместить во внешнюю PSRAM.
    static uint8_t buf_out[SHARED_FRAME_BUF_SIZE]
        __attribute__((aligned(4)))
        Z_GENERIC_SECTION(.ext_ram.bss);
#endif /* CONFIG_ESP32_TRUE */
#if defined(CONFIG_STM32_TRUE)
    static uint8_t buf_out[SHARED_FRAME_BUF_SIZE];     
#endif /* CONFIG_STM32_TRUE */

// Код компилируется только при включённом через конфиг дисплее в проект.
#if defined(CONFIG_DISPLAY_TRUE)
    // Устройство дисплея из Device Tree (/chosen zephyr,display).
    const struct device *const display_dev = DEVICE_DT_GET_OR_NULL(DT_CHOSEN(zephyr_display));
#endif /* CONFIG_DISPLAY_TRUE */  

int main(void)
{
    // Устройство камеры, выбранное в Device Tree через /chosen { zephyr,camera = ... }.
    const struct device *const video_dev   = DEVICE_DT_GET(DT_CHOSEN(zephyr_camera));

    // Указатель на буфер кадра. Изначально указывает на пустую структуру; video_dequeue() перезапишет его.
    struct video_buffer *vbuf = &(struct video_buffer){};
    // Указываем тип буфера — выходной (кадры идут от камеры к приложению).
    vbuf->type = VIDEO_BUF_TYPE_OUTPUT;
    // Формат кадра (разрешение, pixelformat). Заполнится при инициализации камеры.
    struct video_format fmt   = { .type = VIDEO_BUF_TYPE_OUTPUT };
    // Возможности камеры (поддерживаемые форматы и т.п.). Заполнятся при инициализации.
    struct video_caps   caps  = { .type = VIDEO_BUF_TYPE_OUTPUT };
    // Переменная для хранения кодов возврата.
    int ret;

    // Выполнить полный цикл инициализации видеоустройства (камеры) перед запуском видеопотока.
    ret = app_init_video(video_dev, &caps, &fmt);
    if (ret < 0) { goto err; }

    // Код компилируется только при включённом через конфиг дисплее в проект.
    #if defined(CONFIG_DISPLAY_TRUE)
        // Проверка: описан ли дисплей в Device Tree.
        if (DT_HAS_CHOSEN(zephyr_display)) {
            // Настраиваем дисплей под формат пикселей камеры.
            ret = app_setup_display(display_dev, fmt.pixelformat);
            if (ret < 0) { goto err; }
            // Очищаем экран перед началом вывода от шумов.
            ret = app_clear_display(display_dev);
            if (ret < 0) { goto err; }
        }
    #endif /* CONFIG_DISPLAY_TRUE */  

    // Поднимаем сеть, DHCP или WiFi, в зависимости от того какая платформа была выбрана для проекта.
    // Код компилируется только при включённом через конфиг сервере в проект.
    #if defined(CONFIG_SERVER_TRUE)
        // Код компилируется при условии что платформой для проекта выбрана плата STM32.
        #if defined(CONFIG_STM32_TRUE)
            // Указатель на сетевой интерфейс (Ethernet).
            struct net_if *iface;
            // Инициализируем колбэк: handler вызовется, когда интерфейсу назначат IPv4-адрес.
            net_mgmt_init_event_callback(&mgmt_cb, handler, NET_EVENT_IPV4_ADDR_ADD);
            // Регистрируем колбэк в сетевом менеджере событий.
            net_mgmt_add_event_callback(&mgmt_cb);
            // Получаем сетевой интерфейс по умолчанию.
            iface = net_if_get_default();
            // Запускаем DHCP-клиент (адрес придёт асинхронно). 
            net_dhcpv4_start(iface);
        #endif /* CONFIG_STM32_TRUE */

        // Код компилируется при условии что платформой для проекта выбрана плата ESP32.
        #if defined(CONFIG_ESP32_TRUE)
            // Регистрируем WiFi-колбэки.
            wifi_init();

            /* 2. Запускаем подключение к роутеру */
            printk("Connecting to WiFi: %s\r\n", WIFI_SSID);
            if (wifi_connect(WIFI_SSID, WIFI_PSK) != 0) {
                printk("Error: WiFi connect failed\r\n");
                return 0;
            }

            /* 3. Ждем получения IP-адреса от DHCP (блокирующе) */
            wifi_wait_for_ip_addr();
            printk("WiFi Connected and IP obtained! Starting HTTP Server...\n");
        #endif /* CONFIG_ESP32_TRUE */
   
        // ГЛАВНАЯ ФУНКЦИЯ — запускает HTTP/WebSocket сервер.
        http_server_start();
    #endif /* CONFIG_SERVER_TRUE */

    // Запуск видеопотока камеры, камера начинает захватывать кадры в буферы через DMA.
    LOG_INF("Capture started");
    ret = video_stream_start(video_dev, VIDEO_BUF_TYPE_OUTPUT);
    if (ret < 0) {
        LOG_ERR("Unable to start capture (interface)");
        goto err;
    }

    // Создаётся и сразу запускается отдельный поток ядра Zephyr, в котором работает пользовательский интерфейс на LVGL.
    k_thread_create(&ui_thread_data, // адрес управляющей структуры потока (struct k_thread). В ней ядро хранит состояние потока: сохранённые регистры, приоритет, состояние планировщика и т.д.
                    ui_thread_stack, // область памяти под стек потока.
                    K_THREAD_STACK_SIZEOF(ui_thread_stack), // макрос Zephyr, который возвращает ПОЛЕЗНЫЙ размер стека в байтах.
                    ui_thread_entry, // функция-точка входа потока, нутри неё: инициализация LVGL, создание виджетов и бесконечный цикл с lv_timer_handler() и k_msleep().
                    NULL, NULL, NULL, // три произвольных указателя, которые ядро передаст в ui_thread_entry как параметры.
                    UI_THREAD_PRIORITY, // приоритет потока.
                    0, // битовая маска опций потока, 0 - без особых опций (K_USER, K_FP_REGS, K_ESSENTIAL, K_INHERIT_PERMS и др.).
                    K_NO_WAIT); // delay — задержка старта потока.

    // Потоку присваивается читаемое имя (видно в отладчике, в shell-команде "kernel threads", в Thread Analyzer).
    k_thread_name_set(&ui_thread_data, "ui_thread");

    // Структура библиотеки libmpix, описывает изображение и цепочку операций над ним.
    struct mpix_image img = {};
    // Переменная для кодов возврата функций.
    int err;

	/* ============================================================
     * ГЛАВНЫЙ ЦИКЛ ЗАХВАТА КАДРОВ
     *   1. video_dequeue() — извлечь готовый кадр
     *   2. (опционально) memcpy → k_sem_give — передать кадр для дальнейшей обработки
     *   3. video_enqueue() — вернуть буфер драйверу
     * ============================================================ */
    while (1) {
        /* Блокирующее ожидание следующего готового кадра от камеры. */
        ret = video_dequeue(video_dev, &vbuf, K_FOREVER);
        if (ret < 0) {
            LOG_ERR("Unable to dequeue video buf");
            goto err;
        }

        /* Инвалидируем D-Cache, чтобы CPU (через libmpix) прочитал из RAM свежие данные, записанные туда DMA камеры. */
        sys_cache_data_invd_range(vbuf->buffer, vbuf->bytesused);

        /* Структура libmpix, описывающая формат изображения. */
        struct mpix_format my_fmt = {
            // .fourcc = fmt.pixelformat, // код формата пикселей в виде FourCC.
            .fourcc = (fmt.pixelformat == VIDEO_PIX_FMT_RGB565) ? VIDEO_PIX_FMT_RGB565X : fmt.pixelformat,
            .width  = CONFIG_VIDEO_FRAME_WIDTH, // ширина кадра в пикселях.
            .height = CONFIG_VIDEO_FRAME_HEIGHT, // высота кадра в пикселях.
        };

        // Привязка входных данных к контексту libmpix. Заполняет struct mpix_image:
        // запоминает указатель на входные данные, их размер и формат и сбрасывает цепочку операций.
        mpix_image_from_buf(&img, (const uint8_t *)vbuf->buffer, vbuf->bytesused, &my_fmt);

        // Конвертация изображения в RGB24 (по 3 байта на пиксель: R, G, B).
        err = mpix_image_convert(&img, MPIX_FMT_RGB24);
        if (err) {
            LOG_ERR("Failed to convert to RGB24: %d", err);
            return err;
        }

        // Добавление операций коррекции в цепочку обработки изображения: 
        // Вычитает уровень чёрного (убирает паразитную засветку матрицы, чёрный становится по-настоящему чёрным).
        mpix_image_correct_black_level(&img);
        // Выравнивает усиление каналов R и B относительно G, чтобы серые объекты были серыми.
        mpix_image_correct_white_balance(&img);
        // Применяет гамма-кривую (нелинейная яркость, приближает картинку к восприятию глаза).
        mpix_image_correct_gamma(&img);

        // Записывает значение управляющего параметра для операции коррекции со слайдера в контекст изображения:
        // - MPIX_CID_RED_BALANCE  — усиление красного канала
        mpix_image_ctrl_value(&img, MPIX_CID_RED_BALANCE, red_balance * (1 << 10));
        // - MPIX_CID_BLUE_BALANCE — усиление синего канала
        mpix_image_ctrl_value(&img, MPIX_CID_BLUE_BALANCE, blue_balance * (1 << 10));
        // - MPIX_CID_GAMMA_LEVEL  — степень гамма-коррекции.
        mpix_image_ctrl_value(&img, MPIX_CID_GAMMA_LEVEL, gamma_level * (1 << 10));

        // Отладочный вывод текущих значений слайдеров в терминал.
        LOG_INF("RED BALANCE: %.1f", (double)red_balance);
        LOG_INF("BLUE BALANCE: %.1f", (double)blue_balance);
        LOG_INF("GAMMA LEVEL: %.1f", (double)gamma_level);

        // Конвертируем обратно в формат, который использует камера/дисплей.
        // err = mpix_image_convert(&img, fmt.pixelformat);
        err = mpix_image_convert(&img, (fmt.pixelformat == VIDEO_PIX_FMT_RGB565) ? VIDEO_PIX_FMT_RGB565X : fmt.pixelformat);
        if (err) {
            LOG_ERR("Failed to convert back to original format: %d", err);
            return err;
        }

        // Записываем обработанный кадр в buf_out.
        err = mpix_image_to_buf(&img, buf_out, sizeof(buf_out));
        mpix_image_free(&img);
        if (err) {
            LOG_ERR("Failed to write to buf_out: %d", err);
            return err;
        }

        // Код компилируется только при включённом через конфиг сервере в проект.
        #if defined(CONFIG_SERVER_TRUE)
            /* Если предыдущий кадр отправлен */
            if (atomic_cas(&frame_is_sended, 1, 0)) {

                /* Инвалидируем D-Cache, чтобы процессор прочитал из RAM свежие данные DMA */
                sys_cache_data_invd_range(buf_out, SHARED_FRAME_BUF_SIZE);
                /* Копируем кадр из буфера камеры в общий буфер для сетевого потока. */
                memcpy(shared_frame_buf, buf_out, SHARED_FRAME_BUF_SIZE);
                // Сбрасываем кэш в RAM, чтобы сетевой стек/DMA увидел записанные нами данные.
                sys_cache_data_flush_range(shared_frame_buf, SHARED_FRAME_BUF_SIZE);
                // Сообщаем отправляющему потоку реальный размер кадра.
                shared_frame_bytesused = SHARED_FRAME_BUF_SIZE;
                //  Будим поток WebSocket: разрешаем отпраку кадра по соединению вебсокетов.
                k_sem_give(&allowed_2_send);
            }
        #endif /* CONFIG_SERVER_TRUE */

        // Код компилируется только при включённом через конфиг дисплее в проект.
        #if defined(CONFIG_DISPLAY_TRUE)
            // Проверка дисплея (если он задан в Device Tree).
            if (DT_HAS_CHOSEN(zephyr_display)) {
                /* Структура Zephyr, описывающая формат изображения. */
                struct video_buffer display_vbuf = {
                    .buffer    = buf_out, // указатель на область памяти с пикселями.
                    .bytesused = sizeof(buf_out), // сколько байт в нём полезных данных (заполняет драйвер).
                    .size      = sizeof(buf_out), // ёмкость буфера в байтах (сколько вообще влезает).
                    .type      = VIDEO_BUF_TYPE_OUTPUT, // направление буфера (VIDEO_BUF_TYPE_INPUT/OUTPUT).
                };

                // Вывести один видеокадр из буфера камеры на дисплей.
                ret = app_display_frame(display_dev, &display_vbuf, &fmt);
                if (ret != 0) {
                    LOG_WRN("Failed to display this frame");
                }
            }
        #endif /* CONFIG_DISPLAY_TRUE */    

        /* Возвращаем буфер видеодрайверу для следующего захвата DMA.
         * После этого vbuf->buffer принадлежит драйверу — не трогаем! */
        ret = video_enqueue(video_dev, vbuf);
        if (ret < 0) {
            LOG_ERR("Unable to requeue video buf");
            goto err;
        }
    }

err:
    LOG_ERR("Aborting sample");
    return 0;
}
```

## src/thread_ui.c
```c
// Базовые примитивы ядра Zephyr (k_msleep, k_thread_create и т.д.):
#include <zephyr/kernel.h>
// Общее API устройств Zephyr:
#include <zephyr/device.h>
// API дисплеев Zephyr (display_blanking_off):
#include <zephyr/drivers/display.h>
// Макрос MIN(a, b), ARRAY_SIZE(a):
#include <zephyr/sys/util.h>
// Подсистема логирования Zephyr:
#include <zephyr/logging/log.h>

// Библиотека LVGL:
#include <lvgl.h>
#include <stdio.h>

// Поток выделенный под пользовательский интерфейс на базе LVGL.
#include "thread_ui.h"

// Логика WebSocket-сервера.
#include "server.h"

// Регистрирует отдельный модуль логирования UI.
LOG_MODULE_REGISTER(UI, LOG_LEVEL_INF);

// display_dev определён (без static) в main.c, там же, где находятся
// связанные с ним проверки devicetree (#error, если нет zephyr,display).
extern const struct device *const display_dev;

// Палитра - должна совпадать 1:1 с index.html (background:#520707; color:#b8a830;).
#define COLOR_BG        0x520707
#define COLOR_TEXT      0xB8A830

struct slider_ctx {
    lv_obj_t *slider;
    lv_obj_t *label;
    const char *name;
    uint32_t accent_hex;        // NEW: нужен и для стилей, и для recolor-точки в тексте
    const char *ws_type;
    volatile float *value_out;
    atomic_t *dirty_flag;
};

// Статический пул контекстов слайдеров. Размер ограничен -
// create_slider_ui() проверяет переполнение через ARRAY_SIZE().
// Статический пул контекстов слайдеров.
static struct slider_ctx slider_ctxs[10];
static uint8_t slider_count;

// Актуальные значения слайдеров - определение (объявлены extern в
// ui_thread.h, см. подробный комментарий там).
volatile float slider_value_1;
volatile float slider_value_2;
volatile float slider_value_3;



/*
 * Собрать текст подписи в формате index.html: цветная точка (recolor-тег
 * LVGL) + "NAME: X.X", той же цветовой точкой, что и .dot в CSS у
 * соответствующего слайдера.
 */
static void format_slider_label(char *buf, size_t buf_size,
                                 const char *name, uint32_t accent_hex,
                                 float value)
{
    // "#RRGGBB ●# NAME: X.X" - lv_label с включённым recolor красит текст
    // между # #-парами в указанный цвет, здесь - только символ точки.
    snprintf(buf, buf_size, "#%06X \xE2\x97\x8F# %s: %.1f",
              (unsigned int)accent_hex, name, (double)value);
}
/*
 * Обработчик события слайдера.
 * Вызывается LVGL при событии LV_EVENT_VALUE_CHANGED, то есть каждый раз,
 * когда пользователь двигает "бегунок" пальцем по сенсорной панели.
 * Выполняется в контексте ui_thread, т.к. именно там крутится
 * lv_timer_handler(), который и генерирует это событие.
 */
static void slider_event_cb(lv_event_t *e)
{
    lv_obj_t *slider = lv_event_get_target(e);
    struct slider_ctx *ctx = lv_event_get_user_data(e);

    int32_t value = lv_slider_get_value(slider);
    float value_f = value / 10.0f;

    char buf[48];
    format_slider_label(buf, sizeof(buf), ctx->name, ctx->accent_hex, value_f);
    lv_label_set_text(ctx->label, buf);

    *ctx->value_out = value_f;

    LOG_INF("%s = %.1f", ctx->name, (double)value_f);

    ws_broadcast_slider(ctx->ws_type, value_f);
}

/*
 * Создаёт один "блок" слайдера: подпись сверху + слайдер снизу,
 * упакованные в отдельный контейнер-строку внутри parent.
 * Такой блок ведёт себя как единое целое и легко центрируется
 * flex-контейнером родителя и по X, и по Y.
 *
 * accent_color задаёт цвет индикатора/бегунка слайдера и текста подписи,
 * чтобы каждый слайдер визуально отличался.
 */
static void create_slider_ui(lv_obj_t *parent,
                              const char *name,
                              const char *ws_type,
                              int32_t min, int32_t max, int32_t initial,
                              uint32_t accent_hex,        // было lv_color_t accent_color
                              volatile float *value_out,
                              atomic_t *dirty_flag)
{
    if (slider_count >= ARRAY_SIZE(slider_ctxs)) {
        LOG_ERR("Slider limit (%d) exceeded, \"%s\" skipped",
                (int)ARRAY_SIZE(slider_ctxs), name);
        return;
    }

    lv_color_t accent_color = lv_color_hex(accent_hex);

    struct slider_ctx *ctx = &slider_ctxs[slider_count++];
    ctx->name = name;
    ctx->ws_type = ws_type;
    ctx->accent_hex = accent_hex;
    ctx->value_out = value_out;
    ctx->dirty_flag = dirty_flag;

    // Контейнер-строка под пару "подпись + слайдер" - без своего фона,
    // просто прозрачная строка внутри панели (как .slider-row в CSS).
    lv_obj_t *row = lv_obj_create(parent);
    lv_obj_remove_style_all(row);
    lv_obj_set_size(row, lv_pct(90), LV_SIZE_CONTENT);
    lv_obj_set_flex_flow(row, LV_FLEX_FLOW_COLUMN);
    lv_obj_set_flex_align(row,
                           LV_FLEX_ALIGN_CENTER,
                           LV_FLEX_ALIGN_CENTER,
                           LV_FLEX_ALIGN_CENTER);
    lv_obj_set_style_pad_row(row, 4, 0);

    ctx->label = lv_label_create(row);
    lv_label_set_recolor(ctx->label, true);   // включаем разбор #RRGGBB text# тегов
    lv_obj_set_style_text_font(ctx->label, &lv_font_montserrat_14, 0);
    // Основной цвет подписи - золотистый, как .label в CSS (color:#b8a830);
    // точка перед текстом красится отдельно через recolor-тег.
    lv_obj_set_style_text_color(ctx->label, lv_color_hex(COLOR_TEXT), 0);
    lv_obj_set_style_text_align(ctx->label, LV_TEXT_ALIGN_CENTER, 0);
    lv_obj_set_style_text_letter_space(ctx->label, 1, 0);

    char buf[48];
    format_slider_label(buf, sizeof(buf), name, accent_hex, initial / 10.0f);
    lv_label_set_text(ctx->label, buf);

    *ctx->value_out = initial / 10.0f;

    lv_obj_t *slider = lv_slider_create(row);
    ctx->slider = slider;

    lv_obj_set_size(slider, lv_pct(100), 16);
    lv_slider_set_range(slider, min, max);
    lv_slider_set_value(slider, initial, LV_ANIM_OFF);

    // Трек - приглушённый золотисто-полупрозрачный, как .slider-row
    // input[type=range]::-webkit-slider-runnable-track в CSS
    // (background: rgba(184,168,48,.3)).
    lv_obj_set_style_bg_color(slider, lv_color_hex(COLOR_TEXT), LV_PART_MAIN);
    lv_obj_set_style_bg_opa(slider, LV_OPA_30, LV_PART_MAIN);

    // Заполненная часть (индикатор) и бегунок - акцентный цвет слайдера.
    lv_obj_set_style_bg_color(slider, accent_color, LV_PART_INDICATOR);
    lv_obj_set_style_bg_color(slider, accent_color, LV_PART_KNOB);
    // Тёмная окантовка бегунка в тон фону страницы - как .thumb border
    // в CSS (border: 1px solid #520707), а не белая, как в дефолтной теме.
    lv_obj_set_style_border_color(slider, lv_color_hex(COLOR_BG), LV_PART_KNOB);
    lv_obj_set_style_border_width(slider, 2, LV_PART_KNOB);
    lv_obj_set_style_outline_color(slider, accent_color,
                                    LV_PART_KNOB | LV_STATE_FOCUSED);

    lv_obj_add_event_cb(slider, slider_event_cb, LV_EVENT_VALUE_CHANGED, ctx);
}


/*
 * Строит весь UI: заголовок + панель-карточку с тремя
 * центрированными слайдерами.
 */
static void create_ui(void)
{
    lv_obj_t *screen = lv_screen_active();

    // Фон экрана - тот же тёмно-бордовый, что и body в index.html.
    lv_obj_set_style_bg_color(screen, lv_color_hex(COLOR_BG), 0);
    lv_obj_set_flex_flow(screen, LV_FLEX_FLOW_COLUMN);
    lv_obj_set_flex_align(screen,
                           LV_FLEX_ALIGN_START,
                           LV_FLEX_ALIGN_CENTER,
                           LV_FLEX_ALIGN_CENTER);
    lv_obj_set_style_pad_row(screen, 12, 0);
    lv_obj_set_style_pad_top(screen, 8, 0);

    // Заголовок - аналог <h1>Zephyr Stream</h1>: главный элемент, вынесен
    // в самый верх экрана. Раз он рисуется через LVGL flex-layout (а не
    // через прямой display_write, как видео), он безопасно "потеснит"
    // top_spacer/panel вниз на свою высоту, но не заденет физические
    // пиксели видео (те пишутся по фиксированным абсолютным координатам
    // x=160,y=100 в app_display_frame(), в обход LVGL целиком).
    lv_obj_t *title = lv_label_create(screen);
    lv_label_set_text(title, "ZEPHYR STREAM");
    lv_obj_set_style_text_font(title, &lv_font_montserrat_14, 0);
    lv_obj_set_style_text_color(title, lv_color_hex(COLOR_TEXT), 0);
    lv_obj_set_style_text_letter_space(title, 2, 0);

    // Пустой отступ - зарезервирован под область видео, LVGL сюда ничего
    // не рисует (remove_style_all -> нет фона), display_write() пишет
    // напрямую в этот же физический прямоугольник экрана.
    lv_obj_t *top_spacer = lv_obj_create(screen);
    lv_obj_remove_style_all(top_spacer);
    lv_obj_set_size(top_spacer, lv_pct(100), lv_pct(28));

    // Панель-карточка со слайдерами - полупрозрачная тёмная плашка с
    // золотистой рамкой, точь-в-точь как .panel в CSS:
    //   background: rgba(0,0,0,.18);
    //   border: 1px solid rgba(184,168,48,.25);
    //   border-radius: 10px;
    lv_obj_t *panel = lv_obj_create(screen);
    lv_obj_set_width(panel, lv_pct(90));
    lv_obj_set_flex_grow(panel, 1);
    lv_obj_remove_flag(panel, LV_OBJ_FLAG_SCROLLABLE);

    lv_obj_set_style_bg_color(panel, lv_color_hex(0x000000), 0);
    lv_obj_set_style_bg_opa(panel, LV_OPA_20, 0);            // ~.18 rgba alpha
    lv_obj_set_style_border_color(panel, lv_color_hex(COLOR_TEXT), 0);
    lv_obj_set_style_border_opa(panel, LV_OPA_30, 0);         // ~.25 rgba alpha
    lv_obj_set_style_border_width(panel, 1, 0);
    lv_obj_set_style_radius(panel, 10, 0);
    lv_obj_set_style_shadow_width(panel, 0, 0);               // теней в CSS-варианте нет
    lv_obj_set_style_pad_all(panel, 14, 0);
    lv_obj_set_style_pad_row(panel, 18, 0);

    lv_obj_set_flex_flow(panel, LV_FLEX_FLOW_COLUMN);
    lv_obj_set_flex_align(panel,
                           LV_FLEX_ALIGN_CENTER,
                           LV_FLEX_ALIGN_CENTER,
                           LV_FLEX_ALIGN_CENTER);

    // Цвета акцентов те же hex, что и в CSS: --accent у каждого .slider-row.
    create_slider_ui(panel, "RED BALANCE", "red_balance",
                      0, 20, (int32_t)(red_balance * 10.0f + 0.5f),
                      0xE85D5D, &red_balance, &lvgl_dirty_red);
    create_slider_ui(panel, "BLUE BALANCE", "blue_balance",
                      0, 20, (int32_t)(blue_balance * 10.0f + 0.5f),
                      0x3FA37E, &blue_balance, &lvgl_dirty_blue);
    create_slider_ui(panel, "GAMMA LEVEL", "gamma_level",
                      0, 20, (int32_t)(gamma_level * 10.0f + 0.5f),
                      0x4A90D9, &gamma_level, &lvgl_dirty_gamma);
}
/* ------------------------- UI-поток (ui_thread) ------------------------- */

// Область стека потока выделяется статически на этапе компиляции.
// main.c обращается к этому же стеку через K_THREAD_STACK_DECLARE()
// в ui_thread.h.
K_THREAD_STACK_DEFINE(ui_thread_stack, UI_THREAD_STACK_SIZE);

// Структура данных потока (используется ядром Zephyr для планирования).
// Не static - main.c передаёт указатель на неё в k_thread_create().
struct k_thread ui_thread_data;

/*
 * Точка входа UI-потока.
 * Здесь выполняется всё, что связано с дисплеем: инициализация устройства,
 * построение интерфейса (create_ui), включение вывода на экран и главный
 * цикл LVGL (обработка touch-событий слайдеров через slider_event_cb,
 * вывод значений в терминал через LOG_INF и перерисовка экрана).
 * Ни один другой поток LVGL-объекты не трогает, поэтому дополнительная
 * блокировка (мьютекс) здесь не нужна.
 */
void ui_thread_entry(void *arg1, void *arg2, void *arg3)
{
    ARG_UNUSED(arg1);
    ARG_UNUSED(arg2);
    ARG_UNUSED(arg3);

    int ret;

    LOG_INF("LVGL slider sample, display: %s", display_dev->name);

    if (!device_is_ready(display_dev)) {
        LOG_ERR("Device %s not found. Aborting sample.", display_dev->name);
        return;
    }

    // Строим UI один раз при старте.
    create_ui();

    // Включаем реальный вывод изображения на дисплей.
    ret = display_blanking_off(display_dev);
    if (ret < 0 && ret != -ENOSYS) {
        LOG_ERR("Failed to turn blanking off (error %d)", ret);
        return;
    }

    // Главный цикл LVGL: lv_timer_handler() сам обрабатывает touch-события
    // (пришедшие через LVGL indev от touch_dev) и сам перерисовывает экран.
    // Возвращает, через сколько мс его нужно вызвать снова.
    while (1) {


        // Подхватить значения, пришедшие с веб-страницы (см. lvgl_dirty_*).
        for (int i = 0; i < slider_count; i++) {
            struct slider_ctx *ctx = &slider_ctxs[i];

            if (atomic_cas(ctx->dirty_flag, 1, 0)) {
                int32_t raw = (int32_t)(*ctx->value_out * 10.0f + 0.5f);

                lv_slider_set_value(ctx->slider, raw, LV_ANIM_OFF);

                char buf[48];
                format_slider_label(buf, sizeof(buf), ctx->name, ctx->accent_hex, *ctx->value_out);
                lv_label_set_text(ctx->label, buf);
            }
        }

        uint32_t sleep_ms = lv_timer_handler();

        k_msleep(MIN(sleep_ms, INT32_MAX));
    }
}
```

## src/thread_ui.h
```c
#ifndef THREAD_UI_H_
#define THREAD_UI_H_

#include <zephyr/kernel.h>

/*
 * Всё, что связано со слайдерами, интерфейсом LVGL и потоком, который
 * этим занимается, реализовано в ui_thread.c. Здесь - только то, что
 * должно быть видно снаружи (в main.c), чтобы там можно было создать
 * и запустить этот поток через k_thread_create().
 */

// Размер стека UI-потока. LVGL (разбор шрифтов, флекс-раскладка, обработка
// touch-событий) требует заметно больше стека, чем обычный поток "по
// умолчанию" - если раньше вся эта логика уже стабильно работала в main()
// с CONFIG_MAIN_STACK_SIZE из prj.conf, возьмите то же значение здесь.
// Если стек окажется маленьким, будет либо жёсткий крэш/reset, либо (при
// включённом CONFIG_STACK_SENTINEL/CONFIG_THREAD_STACK_INFO) понятная
// ошибка "stack overflow" в логе - в этом случае просто увеличьте это число.
#define UI_THREAD_STACK_SIZE 8192

// Приоритет UI-потока. Положительное число = вытесняемый (preemptible)
// поток; чем меньше число, тем выше приоритет. 5 - средний приоритет,
// достаточный, чтобы UI не "подвисал", но не мешающий более критичным
// системным потокам (например, будущим потокам с датчиками/связью).
#define UI_THREAD_PRIORITY 5

// Стек потока физически выделен (K_THREAD_STACK_DEFINE) в ui_thread.c.
// K_THREAD_STACK_DECLARE даёт этому же символу внешнюю (extern) видимость
// здесь, чтобы main.c мог передать его в k_thread_create().
K_THREAD_STACK_DECLARE(ui_thread_stack, UI_THREAD_STACK_SIZE);

// Структура данных потока тоже определена в ui_thread.c - main.c получает
// на неё указатель через объявление extern.
extern struct k_thread ui_thread_data;

/*
 * Актуальные значения слайдеров. Пишутся в ui_thread (из slider_event_cb
 * при каждом движении слайдера), читаются из main() в основном потоке.
 * volatile - чтобы компилятор каждый раз действительно перечитывал
 * значение из памяти, а не использовал закэшированную в регистре копию.
 * Для одиночного float такого выровненного чтения/записи достаточно: на
 * 32-битных платформах (Cortex-M, Xtensa и т.п.) это атомарная операция
 * на уровне шины. Если в будущем понадобится передавать составное
 * значение (структуру из нескольких полей) - volatile уже не защитит от
 * "разрыва" данных между потоками, там будет нужен мьютекс.
 */
extern volatile float slider_value_1;
extern volatile float slider_value_2;
extern volatile float slider_value_3;

/*
 * Точка входа UI-потока: инициализация дисплея, построение интерфейса
 * (слайдеры), главный цикл LVGL (обработка touch-событий и вывод значений
 * слайдеров в терминал). Реализация - в ui_thread.c, регистрируется в
 * main() через k_thread_create().
 */
void ui_thread_entry(void *arg1, void *arg2, void *arg3);

#endif /* THREAD_UI_H_ */
```
