## CMakeLists.txt
```
# Устанавливаем минимально требуемую версию CMake для Zephyr.
cmake_minimum_required(VERSION 3.20.0)

# Подключаем пакет Zephyr: инициализирует всю сборочную инфраструктуру Zephyr.
# Создаём целевой объект app обладающий свойствами, зависимостями и правилами сборки.
find_package(Zephyr REQUIRED HINTS $ENV{ZEPHYR_BASE})
# Подключаем Python для Zephyr, так как он использует Python-скрипты для генерации кода.
find_package(Python REQUIRED COMPONENTS Interpreter)

# Задаём имя проекта.
project(correct_video)

# Задаём переменную gen_dir — путь к каталогу сгенерированных файлов.
# Куда Zephyr и его скрипты складывают сгенерированные заголовочные файлы.
set(gen_dir ${ZEPHYR_BINARY_DIR}/include/generated/)


# Задаём путь к скрипту для преобразования jpg изображение в raw.inc массив данных.
set(LOGO_CONVERT_SCRIPT ${CMAKE_CURRENT_LIST_DIR}/src/custom_mpix/scripts/convert_logo.py)
# Задаём путь к jpg изображению.
set(LOGO_SOURCE_IMAGE   ${CMAKE_CURRENT_LIST_DIR}/src/image/logo.png)
# Задаём путь к raw.inc массиву данных.
set(LOGO_OUTPUT_INC     ${gen_dir}/logo.raw.inc)
# Задаём ширину и высоту изображения.
set(LOGO_WIDTH  57)
set(LOGO_HEIGHT 33)

# Преобразуем jpg изображение в raw.inc массив данных.
add_custom_command(OUTPUT ${LOGO_OUTPUT_INC}
    COMMAND ${Python_EXECUTABLE} ${LOGO_CONVERT_SCRIPT}
            ${LOGO_SOURCE_IMAGE} ${LOGO_OUTPUT_INC}
            --width ${LOGO_WIDTH} --height ${LOGO_HEIGHT}
    DEPENDS ${LOGO_SOURCE_IMAGE} ${LOGO_CONVERT_SCRIPT}
    COMMENT "Converting ${LOGO_SOURCE_IMAGE} to RGB24 .inc (${LOGO_WIDTH}x${LOGO_HEIGHT})"
)


# Добавляем исходный файл src/main.c в целевой объект app.
target_sources(app PRIVATE src/main.c
                           src/thread_processing.c
                           ${LOGO_OUTPUT_INC})

# Добавление подкаталога с собственной библиотекой в процесс сборки.
add_subdirectory(src/basic_functions)

# Линковка библиотеки с приложением связывает библиотеку с app.
target_link_libraries(app PRIVATE basic_functions)

# Добавление подкаталога с собственной библиотекой в процесс сборки.
add_subdirectory(src/custom_mpix)

# Линковка библиотеки с приложением связывает библиотеку с app.
target_link_libraries(app PRIVATE custom_mpix)

# Устанавливаем переменную gen_dir — путь к каталогу сгенерированных файлов.
# Куда Zephyr и его скрипты складывают сгенерированные заголовочные файлы.
# set(gen_dir ${ZEPHYR_BINARY_DIR}/include/generated/)


if(CONFIG_SERVER_TRUE)
  # Опция INCLUDE_HTML_CONTENT это CMake-переменная, которая будет использована
  # для условного включения HTML-файлов в прошивку.
  option(INCLUDE_HTML_CONTENT "Include the HTML content" ON)

  # Добавляем фрагмент скрипта компоновщика в общую сборку.
  # Этот файл определяет итерируемую ROM-секцию для дескрипторов HTTP-ресурсов.
  # Без этого файла HTTP-сервер не сможет найти зарегистрированные статические ресурсы.
  zephyr_linker_sources(SECTIONS src/static_web_resources/sections-rom.ld)

  # Zephyr создаёт специальную область памяти, где будут храниться HTTP ресурсы.
  zephyr_linker_section_ifdef(CONFIG_NET_VIDEO_HTTP_SERVICE
    NAME http_resource_desc_video_http_service
    KVMA RAM_REGION GROUP RODATA_REGION
  )

  # Цикл по списку web-ресурсов для их сжатия и дальнейшего преобразование в C-заголовочный файл с байтовым массивом.
  foreach(web_resource index.html)
    generate_inc_file_for_target(app
      src/static_web_resources/${web_resource}
      ${gen_dir}/${web_resource}.gz.inc
      --gzip
    )
  endforeach()
endif()

# Функция подключает все необходимые .c-файлы библиотеки libmpix к проекту.
libmpix_init(app)
```

## prj.conf
```kconfig
# Включает кастомный сервис трансляции видео по WebSocket, определенный в Kconfig-файле проекта.
CONFIG_NET_VIDEO_WEBSOCKET_SERVICE=y

# Позволяет Zephyr в рантайме мониторить реальное использование стека и точно определять, если какому-то потоку начинает не хватать памяти.
CONFIG_INIT_STACKS=y
# Устанавливает размер стека главного потока main() в 4 КБ.
CONFIG_MAIN_STACK_SIZE=4096
# Размер стека системной рабочей очереди для отложенного выполнения задач.
CONFIG_SYSTEM_WORKQUEUE_STACK_SIZE=2048

# Включает интерактивную командную строку, позволяет подключаться к устройству через UART или USB-консоль и вводить команды для отладки.
CONFIG_SHELL=y
# Активирует глобальную систему логирования, которая позволяет выводить отладочные сообщения в консоль.
CONFIG_LOG=y

# Включают генераторы случайных чисел. 
# Необходимы криптографическим подсистемам и сетевому стеку для генерации случайных идентификаторов сессий и портов.
CONFIG_ENTROPY_GENERATOR=y
CONFIG_TEST_RANDOM_GENERATOR=y

# Включает встроенную в Zephyr библиотеку для работы с JSON.
CONFIG_JSON_LIBRARY=y

# Позволяет устройству выступать в роли HTTP-клиента
CONFIG_HTTP_CLIENT=y
# Активирует встроенный легковесный HTTP-сервер Zephyr для отдачи веб-страниц.
CONFIG_HTTP_SERVER=y
# Добавляет поддержку протокола WebSocket для HTTP-сервера.
CONFIG_HTTP_SERVER_WEBSOCKET=y

# Включает официальный HTTP-парсер (на базе node.js http-parser) и отдельную опцию разбора URL.
# Позволяет серверу корректно парсить входящие HTTP-запросы, заголовки и пути.
CONFIG_HTTP_PARSER_URL=y
CONFIG_HTTP_PARSER=y

# Networking config
# Главный переключатель сетевого стека Zephyr.
CONFIG_NETWORKING=y
# Включает поддержку протокола IPv4.
CONFIG_NET_IPV4=y
# Отключает IPv6 для экономии оперативной и флеш-памяти микроконтроллера.
CONFIG_NET_IPV6=n
# Включает транспортный протокол TCP (база для HTTP и WebSockets).
CONFIG_NET_TCP=y
# Включает POSIX-совместимый API сокетов (socket(), bind(), listen()), упрощающий написание сетевого кода.
CONFIG_NET_SOCKETS=y
# Менеджер сетевых подключений для координации работы интерфейсов.
CONFIG_NET_CONNECTION_MANAGER=y
# Добавляет сетевые команды в консоль (например, net iface, ping).
CONFIG_NET_SHELL=y

# Включает уровень канального доступа (Layer 2) для Ethernet-контроллеров.
CONFIG_NET_L2_ETHERNET=y
# Включает клиент DHCPv4, позволяющий устройству автоматически получать IP-адрес от роутера.
CONFIG_NET_DHCPV4=y
# Включает клиент разрешения доменных имен (DNS).
CONFIG_DNS_RESOLVER=y

# Настройка пулов памяти под сетевые пакеты (net_pkt) и блоки буферов (net_buf).
CONFIG_NET_PKT_RX_COUNT=16
CONFIG_NET_PKT_TX_COUNT=16
CONFIG_NET_BUF_RX_COUNT=128
CONFIG_NET_BUF_TX_COUNT=128
CONFIG_NET_CONTEXT_NET_PKT_POOL=y

# Network address config
# Отключение статической предконфигурации сетевых адресов.
# Поскольку выше включен DHCPv4, ручное жесткое задание IP-адресов отключено. Устройство получает параметры динамически.
CONFIG_NET_CONFIG_SETTINGS=n
CONFIG_NET_CONFIG_NEED_IPV4=n
CONFIG_NET_CONFIG_NEED_IPV6=n
# CONFIG_NET_CONFIG_MY_IPV4_ADDR="192.0.2.1"
# CONFIG_NET_CONFIG_PEER_IPV4_ADDR="192.0.2.2"
# CONFIG_NET_CONFIG_MY_IPV4_GW="192.0.2.2"
# CONFIG_NET_CONFIG_MY_IPV6_ADDR="2001:db8::1"
# CONFIG_NET_CONFIG_PEER_IPV6_ADDR="2001:db8::2"

# Убирает задержку в состоянии TIME_WAIT для закрывающихся TCP-соединений.
CONFIG_NET_TCP_TIME_WAIT_DELAY=0

# Ограничение максимального числа одновременных сетевых контекстов и TCP-соединений до 10.
# Предотвращает перерасход оперативной памяти
CONFIG_NET_MAX_CONTEXTS=10
CONFIG_NET_MAX_CONN=10

# Подсистема управления сетью и генерации событий.
# Позволяет коду приложения отслеживать системные события (например, «линк поднят», «IP получен») через колбэки.
CONFIG_NET_MGMT=y
CONFIG_NET_MGMT_EVENT=y


# General config
# Требует подключения полной стандартной библиотеки языка C (а не урезанной мини-версии вроде picolibc).
# Необходима для корректной работы сторонних библиотек и сложных алгоритмов обработки данных.
CONFIG_REQUIRES_FULL_LIBC=y
# Подсистема ввода (кнопки, датчики).
CONFIG_INPUT=y
# Включает шину SPI (используется для дисплеев или камер).
CONFIG_SPI=y
# Базовый контроль портов ввода-вывода (управление пинами).
CONFIG_GPIO=y
# CONFIG_LED=y

# Подсистема захвата и обработки видео (работа с камерами, фреймбуферами).
CONFIG_VIDEO=y
# Подсистема вывода графики на экран дисплея.
CONFIG_DISPLAY=y
# Включает UART/USB консоль для управления устройствами.
CONFIG_DEVICE_SHELL=y

# Включает быстрый вывод сообщений ядра в консоль.
CONFIG_PRINTK=y
# Включает поддержку вывода чисел с плавающей точкой (float/double) в функциях форматированного вывода (printk/printf).
CONFIG_CBPRINTF_FP_SUPPORT=y
# Гарантирует поддержку вывода float на уровне глобального форматирования.
CONFIG_REQUIRES_FLOAT_PRINTF=y

# Подключить API обёртку для POSIX (Portable Operating System Interface) стандарта.
CONFIG_POSIX_API=y
# Event File Descriptors - включает поддержку механизма POSIX-совместимого способа уведомления о событиях через файловые дескриптор.
CONFIG_EVENTFD=y

# ZVFS (Zephyr Virtual Filesystem) - мост между Zephyr и стандартами POSIX/C для работы с файлами, сокетами и устройствами.
# Значение 32 означает, что можно одновременно опрашивать до 32 сокетов или других файловых дескрипторов. 
CONFIG_ZVFS_POLL_MAX=32
# Максимальное количество событий для сетевых подсистем (HTTP-сервер, CoAP-сервер, LwM2M, PTP, SSH, socket service) .
CONFIG_ZVFS_EVENTFD_MAX=4
# Дополнительное количество слотов для открытых файловых дескрипторов для обработки одновременных клиентских соединений.
CONFIG_ZVFS_OPEN_ADD_SIZE_NET_SAMPLE=24


# Включение алгоритма хеширования SHA-1 в криптографическом бэкенде mbedTLS (через стандартизированный API PSA Crypto).
# Протокол WebSocket на этапе рукопожатия (Sec-WebSocket-Accept) требует обязательного вычисления хеша SHA-1 от специального ключа клиента.
CONFIG_PSA_WANT_ALG_SHA_1=y
CONFIG_MBEDTLS_SHA1=y



# ==========================================================================
# Включает подсистему дисплея Zephyr, именно через эту подсистему LVGL получает доступ к дисплею.
CONFIG_DISPLAY=y
# В отложенном режиме сообщения в подсистеме логирования не выводятся немедленно, а помещаются в буфер и обрабатываются фоновым потоком.
CONFIG_LOG_MODE_DEFERRED=y
# Задаёт размер системной кучи ядра Zephyr в байтах. Драйверы (дисплея и input) используют динамическое выделение памяти под буферы.
CONFIG_HEAP_MEM_POOL_SIZE=46144

# Включает драйвер резистивного тачскрина XPT2046. Драйвер работает через шину SPI и создаёт устройство ввода в подсистеме input.
CONFIG_INPUT_XPT2046=y
# Включает поддержку шины SPI на уровне драйверов Zephyr. SPI необходим для работы дисплея и сенсорной панели.
CONFIG_SPI=y
# Включает подсистему GPIO Zephyr. Нужна для управления пинами (сброс дисплея, прерывание тачскрина, подсветка)
CONFIG_GPIO=y

# Устанавливает уровень логирования для подсистемы input на DBG (debug). Это самый подробный уровень - выводятся все отладочные сообщения.
# CONFIG_INPUT_LOG_LEVEL_DBG=y

# # Включает графическую библиотеку LVGL как модуль Zephyr. 
# CONFIG_LVGL=y
# # Задаёт глубину цвета LVGL - 16 бит на пиксель, формат RGB565 на ST7796.
# CONFIG_LV_COLOR_DEPTH_16=y

# # Включает подсистему ввода Zephyr. Это обязательное условие для работы любого драйвера ввода (включая XPT2046) и для связки с LVGL.
# CONFIG_INPUT=y
# # Включает мост между подсистемой input Zephyr и LVGL. Этот код слушает события от устройства ввода и преобразует их в lv_indev_data_t.
# CONFIG_LV_Z_POINTER_INPUT=y

# # Включает виджет slider (ползунок) в сборке LVGL.
# CONFIG_LV_USE_SLIDER=y
# # Модуль LVGL при инициализации находит устройство, на которое указывает zephyr,touch, и подписывается на его события. 
# CONFIG_LV_Z_POINTER_FROM_CHOSEN_TOUCH=y

# # Задаёт размер кучи, выделенной специально для LVGL, в байтах.
# CONFIG_LV_Z_MEM_POOL_SIZE=16384
# # Включает встроенную систему логирования LVGL.
# CONFIG_LV_USE_LOG=y
# # Сообщает интеграционному слою LVGL/Zephyr, сколько бит на пиксель используется в буферах дисплея.
# CONFIG_LV_Z_BITS_PER_PIXEL=16
# # Выполняет байтовый своп для 16-битных цветов RGB565. Без свопа вы увидите инвертированные цвета.
# CONFIG_LV_COLOR_16_SWAP=y


# Включает библиотеку libmpix — легковесную библиотеку для обработки пиксельных данных на микроконтроллерах.
CONFIG_MPIX=y
```

## src/thread_processing.c
```c
#include <string.h>

#include <zephyr/kernel.h>
#include <zephyr/device.h>
#include <zephyr/cache.h>
#include <zephyr/sys/util.h>
#include <zephyr/drivers/display.h>
#include <zephyr/drivers/video.h>
#include <zephyr/logging/log.h>
#include <zephyr/drivers/video.h>

#include <mpix/image.h>

#include "thread_processing.h"

// Логика работы с дисплеем (app_display_frame).
#include "display.h"
// Логика WebSocket-сервера (frame_is_sended, shared_frame_buf, allowed_2_send, shared_fmt ...).
#include "server.h"

// Подключим функции для обработки изображения.
#include "custom_mpix_combine.h"
// Ширина и высота логотипа.
#define LOGO_WIDTH  57
#define LOGO_HEIGHT 33

// Логотип в формате RGB24.
static const uint8_t logo_rgb24[] = {
    #include "logo.raw.inc"
};



// Регистрирует отдельный модуль логирования UI.
LOG_MODULE_REGISTER(PROCESSING, LOG_LEVEL_INF);

/* Устройство дисплея определено в main.c. */
extern const struct device *const display_dev;
// Формат кадра (разрешение, pixelformat). Заполнится при инициализации камеры.
struct video_format shared_fmt;

/* ------------------------------------------------------------------------------------------------- */
/*                                      Общие данные потока                                           */
/* ------------------------------------------------------------------------------------------------- */

/* Буферы для работы с изображением. */
#if defined(CONFIG_ESP32_TRUE)
    // Для ESP32 буфер следует разместить во внешнюю PSRAM.
    static uint8_t buf_out[SHARED_FRAME_BUF_SIZE]
        __attribute__((aligned(4)))
        Z_GENERIC_SECTION(.ext_ram.bss);

    uint8_t buf_processing[CONFIG_VIDEO_FRAME_WIDTH * CONFIG_VIDEO_FRAME_HEIGHT * 3]
        __attribute__((aligned(4)))
        Z_GENERIC_SECTION(.ext_ram.bss);
#endif /* CONFIG_ESP32_TRUE */
#if defined(CONFIG_STM32_TRUE)
    static uint8_t buf_out[SHARED_FRAME_BUF_SIZE];
    
    uint8_t buf_processing[CONFIG_VIDEO_FRAME_WIDTH * CONFIG_VIDEO_FRAME_HEIGHT * 3];
#endif /* CONFIG_STM32_TRUE */

// Флаг дающий понять что процесс обработки кадра завершён.
atomic_t frame_processing_is_done = ATOMIC_INIT(1);

// Семафор ожидающий новый кадр из main.
K_SEM_DEFINE(allowed_2_process, 0, 1);

/* Структура libmpix, описывающая формат изображения. */
struct mpix_format my_fmt;

/* ------------------------------------------------------------------------------------------------- */
/*                                   Поток обработки изображения                                      */
/* ------------------------------------------------------------------------------------------------- */

#define PROCESSING_THREAD_STACK_SIZE 1000
#define PROCESSING_THREAD_PRIORITY   7

K_THREAD_STACK_DEFINE(processing_thread_stack, PROCESSING_THREAD_STACK_SIZE);
static struct k_thread processing_thread_data;

/* Поток обработки кадра.
 * Алгоритм работы:
 *   1. Дождаться готового RGB24 кадра от main() (allowed_2_process).
 *   2. Нанести графику и текст на кадр (custom_mpix_draw_*).
 *   3. Конвертировать кадр обратно в нативный формат камеры (my_fmt.fourcc).
 *   4. Отдать буфер обратно main()/следующему кадру (frame_processing_is_done = 1).
 *   5. Скопировать готовый кадр на отправку по WebSocket.
 *   6. Вывести готовый кадр на дисплей (если он задан в Device Tree). */
static void processing_thread_start(void *arg1, void *arg2, void *arg3)
{
	ARG_UNUSED(arg1);
	ARG_UNUSED(arg2);
	ARG_UNUSED(arg3);

	int ret;
	int err;

	/* Изображение libmpix для обработки кадра. */
	struct mpix_image img_process = {};

	/* Холст для рисования поверх RGB24-буфера. */
	// struct custom_mpix_canvas canvas;

	/* Описание формата данных, лежащих в buf_processing —
	 * это ВСЕГДА RGB24 160x120, т.к. main() кладёт туда кадр уже
	 * сконвертированным. В отличие от my_fmt (нативный формат камеры),
	 * этот дескриптор нужен только внутри потока обработки. */
	struct mpix_format process_fmt = {
		.fourcc = MPIX_FMT_RGB24,
		.width  = CONFIG_VIDEO_FRAME_WIDTH,
		.height = CONFIG_VIDEO_FRAME_HEIGHT,
	};


	// Структура содержащая параметры для удаления белого фона с наносимого на изображение логотипа.
	struct custom_mpix_combine_config combine_cfg = {
        .use_chroma_key = true,
        // .chroma_key_r = 0, .chroma_key_g = 0, .chroma_key_b = 0, /* чёрный - "прозрачный" */
        .chroma_key_r = 230, .chroma_key_g = 230, .chroma_key_b = 230, /* белый - "прозрачный" */
    };


	while (1) {

		/* Ждать пока main() полностью скопирует новый RGB24-кадр
		 * в buf_processing. */
		k_sem_take(&allowed_2_process, K_FOREVER);

		/* Инвалидируем D-Cache перед чтением буфера, т.к. main()
		 * писал в него из другого потока/ядра. */
		sys_cache_data_invd_range(buf_processing, FRAME_RGB24_SIZE);

		// Объеденяем два изображения.
        err = custom_mpix_combine_insert_rgb24(buf_processing, CONFIG_VIDEO_FRAME_WIDTH, CONFIG_VIDEO_FRAME_HEIGHT,
                            logo_rgb24, LOGO_WIDTH, LOGO_HEIGHT,
                            100, 5, &combine_cfg);
        if (err) {
            LOG_WRN("Combine insert failed: %d", err);
        }

		/* Оборачиваем модифицированный RGB24-буфер в mpix_image,
		 * чтобы сконвертировать его обратно в нативный формат камеры/дисплея. */
		mpix_image_from_buf(&img_process, buf_processing, FRAME_RGB24_SIZE, &process_fmt);

		err = mpix_image_convert(&img_process, my_fmt.fourcc);
		if (err) {
			LOG_ERR("Failed to convert back to original format: %d", err);
			mpix_image_free(&img_process);
			atomic_set(&frame_processing_is_done, 1);
			continue;
		}

		/* Забираем итоговый кадр в buf_out. */
		err = mpix_image_to_buf(&img_process, buf_out, sizeof(buf_out));
		mpix_image_free(&img_process);
		if (err) {
			LOG_ERR("Failed to write to buf_out: %d", err);
			atomic_set(&frame_processing_is_done, 1);
			continue;
		}

		/* buf_processing нам больше не нужен — освобождаем
		 * его для main(), чтобы захват следующего кадра не простаивал. */
		atomic_set(&frame_processing_is_done, 1);

		/* Отправка обработанного кадра по WebSocket. */
		size_t copy_size = MIN(sizeof(buf_out), SHARED_FRAME_BUF_SIZE);

		// Код компилируется только при включённом через конфиг сервере в проект.
        #if defined(CONFIG_SERVER_TRUE)
			/* Если предыдущий кадр отправлен на вебстраничку. */
			if (atomic_cas(&frame_is_sended, 1, 0)) {
				/* Копируем кадр из буфера камеры в общий буфер для сетевого потока. */
				memcpy(shared_frame_buf, buf_out, copy_size);
				// Сбрасываем кэш в RAM, чтобы сетевой стек/DMA увидел записанные нами данные.
				sys_cache_data_flush_range(shared_frame_buf, copy_size);
				// Сообщаем отправляющему потоку реальный размер кадра.
				shared_frame_bytesused = copy_size;
				//  Будим поток WebSocket: разрешаем отпраку кадра по соединению вебсокетов.
				k_sem_give(&allowed_2_send);
			}
		#endif /* CONFIG_SERVER_TRUE */

		// Код компилируется только при включённом через конфиг дисплее в проект.
        #if defined(CONFIG_DISPLAY_TRUE)
			/* Проверка дисплея (если он задан в Device Tree). */
			if (DT_HAS_CHOSEN(zephyr_display)) {
				struct video_buffer display_vbuf = {
					.buffer    = buf_out,
					.bytesused = sizeof(buf_out),
					.size      = sizeof(buf_out),
					.type      = VIDEO_BUF_TYPE_OUTPUT,
				};
				ret = app_display_frame(display_dev, &display_vbuf, &shared_fmt);
				if (ret != 0) {
					LOG_WRN("Failed to display this frame");
				}
			}
		#endif /* CONFIG_DISPLAY_TRUE */  
	}
}


void processing_thread_init(void)
{
	k_thread_create(&processing_thread_data, processing_thread_stack,
			K_THREAD_STACK_SIZEOF(processing_thread_stack),
			processing_thread_start, NULL, NULL, NULL,
			PROCESSING_THREAD_PRIORITY, 0, K_NO_WAIT);
	k_thread_name_set(&processing_thread_data, "processing_thread");
}
```
