## CMakeLists.txt
```
# Устанавливаем минимально требуемую версию CMake для Zephyr.
cmake_minimum_required(VERSION 3.20.0)

# Подключаем пакет Zephyr: инициализирует всю сборочную инфраструктуру Zephyr.
# Создаём целевой объект app обладающий свойствами, зависимостями и правилами сборки.
find_package(Zephyr REQUIRED HINTS $ENV{ZEPHYR_BASE})
# Подключаем Python для Zephyr, так как он использует Python-скрипты для генерации кода.
find_package(Python REQUIRED COMPONENTS Interpreter)

# Задаём имя проекта.
project(correct_video)

# Задаём опцию для работы TensorFlow Lite, локальные static в C++ без потокобезопасной инициализации.
set(NO_THREADSAFE_STATICS $<TARGET_PROPERTY:compiler-cpp,no_threadsafe_statics>)
zephyr_compile_options($<$<COMPILE_LANGUAGE:CXX>:${NO_THREADSAFE_STATICS}>)

# Добавляем исходный файл src/main.c в целевой объект app.
target_sources(app PRIVATE src/main.c
                           src/thread_processing.c
                           src/model.hpp
                           src/tflm_wrapper.cpp
                           src/det_postprocess.c)

# Добавление подкаталога с собственной библиотекой в процесс сборки.
add_subdirectory(src/basic_functions)

# Линковка библиотеки с приложением связывает библиотеку с app.
target_link_libraries(app PRIVATE basic_functions)

# Добавление подкаталога с собственной библиотекой в процесс сборки.
add_subdirectory(src/custom_mpix)

# Линковка библиотеки с приложением связывает библиотеку с app.
target_link_libraries(app PRIVATE custom_mpix)

# Устанавливаем переменную gen_dir — путь к каталогу сгенерированных файлов.
# Куда Zephyr и его скрипты складывают сгенерированные заголовочные файлы.
set(gen_dir ${ZEPHYR_BINARY_DIR}/include/generated/)


if(CONFIG_SERVER_TRUE)
  # Опция INCLUDE_HTML_CONTENT это CMake-переменная, которая будет использована
  # для условного включения HTML-файлов в прошивку.
  option(INCLUDE_HTML_CONTENT "Include the HTML content" ON)

  # Добавляем фрагмент скрипта компоновщика в общую сборку.
  # Этот файл определяет итерируемую ROM-секцию для дескрипторов HTTP-ресурсов.
  # Без этого файла HTTP-сервер не сможет найти зарегистрированные статические ресурсы.
  zephyr_linker_sources(SECTIONS src/static_web_resources/sections-rom.ld)

  # Zephyr создаёт специальную область памяти, где будут храниться HTTP ресурсы.
  zephyr_linker_section_ifdef(CONFIG_NET_VIDEO_HTTP_SERVICE
    NAME http_resource_desc_video_http_service
    KVMA RAM_REGION GROUP RODATA_REGION
  )

  # Цикл по списку web-ресурсов для их сжатия и дальнейшего преобразование в C-заголовочный файл с байтовым массивом.
  foreach(web_resource index.html)
    generate_inc_file_for_target(app
      src/static_web_resources/${web_resource}
      ${gen_dir}/${web_resource}.gz.inc
      --gzip
    )
  endforeach()
endif()

# Функция подключает все необходимые .c-файлы библиотеки libmpix к проекту.
libmpix_init(app)
```

## prj.conf
```kconfig
# Включает кастомный сервис трансляции видео по WebSocket, определенный в Kconfig-файле проекта.
CONFIG_NET_VIDEO_WEBSOCKET_SERVICE=y

# Позволяет Zephyr в рантайме мониторить реальное использование стека и точно определять, если какому-то потоку начинает не хватать памяти.
CONFIG_INIT_STACKS=y
# Устанавливает размер стека главного потока main() в 4 КБ.
CONFIG_MAIN_STACK_SIZE=4096
# Размер стека системной рабочей очереди для отложенного выполнения задач.
CONFIG_SYSTEM_WORKQUEUE_STACK_SIZE=2048

# Включает интерактивную командную строку, позволяет подключаться к устройству через UART или USB-консоль и вводить команды для отладки.
CONFIG_SHELL=y
# Активирует глобальную систему логирования, которая позволяет выводить отладочные сообщения в консоль.
CONFIG_LOG=y

# Включают генераторы случайных чисел. 
# Необходимы криптографическим подсистемам и сетевому стеку для генерации случайных идентификаторов сессий и портов.
CONFIG_ENTROPY_GENERATOR=y
CONFIG_TEST_RANDOM_GENERATOR=y

# Включает встроенную в Zephyr библиотеку для работы с JSON.
CONFIG_JSON_LIBRARY=y

# Позволяет устройству выступать в роли HTTP-клиента
CONFIG_HTTP_CLIENT=y
# Активирует встроенный легковесный HTTP-сервер Zephyr для отдачи веб-страниц.
CONFIG_HTTP_SERVER=y
# Добавляет поддержку протокола WebSocket для HTTP-сервера.
CONFIG_HTTP_SERVER_WEBSOCKET=y

# Включает официальный HTTP-парсер (на базе node.js http-parser) и отдельную опцию разбора URL.
# Позволяет серверу корректно парсить входящие HTTP-запросы, заголовки и пути.
CONFIG_HTTP_PARSER_URL=y
CONFIG_HTTP_PARSER=y

# Networking config
# Главный переключатель сетевого стека Zephyr.
CONFIG_NETWORKING=y
# Включает поддержку протокола IPv4.
CONFIG_NET_IPV4=y
# Отключает IPv6 для экономии оперативной и флеш-памяти микроконтроллера.
CONFIG_NET_IPV6=n
# Включает транспортный протокол TCP (база для HTTP и WebSockets).
CONFIG_NET_TCP=y
# Включает POSIX-совместимый API сокетов (socket(), bind(), listen()), упрощающий написание сетевого кода.
CONFIG_NET_SOCKETS=y
# Менеджер сетевых подключений для координации работы интерфейсов.
CONFIG_NET_CONNECTION_MANAGER=y
# Добавляет сетевые команды в консоль (например, net iface, ping).
CONFIG_NET_SHELL=y

# Включает уровень канального доступа (Layer 2) для Ethernet-контроллеров.
CONFIG_NET_L2_ETHERNET=y
# Включает клиент DHCPv4, позволяющий устройству автоматически получать IP-адрес от роутера.
CONFIG_NET_DHCPV4=y
# Включает клиент разрешения доменных имен (DNS).
CONFIG_DNS_RESOLVER=y

# Настройка пулов памяти под сетевые пакеты (net_pkt) и блоки буферов (net_buf).
CONFIG_NET_PKT_RX_COUNT=16
CONFIG_NET_PKT_TX_COUNT=16
CONFIG_NET_BUF_RX_COUNT=128
CONFIG_NET_BUF_TX_COUNT=128
CONFIG_NET_CONTEXT_NET_PKT_POOL=y

# Network address config
# Отключение статической предконфигурации сетевых адресов.
# Поскольку выше включен DHCPv4, ручное жесткое задание IP-адресов отключено. Устройство получает параметры динамически.
CONFIG_NET_CONFIG_SETTINGS=n
CONFIG_NET_CONFIG_NEED_IPV4=n
CONFIG_NET_CONFIG_NEED_IPV6=n
# CONFIG_NET_CONFIG_MY_IPV4_ADDR="192.0.2.1"
# CONFIG_NET_CONFIG_PEER_IPV4_ADDR="192.0.2.2"
# CONFIG_NET_CONFIG_MY_IPV4_GW="192.0.2.2"
# CONFIG_NET_CONFIG_MY_IPV6_ADDR="2001:db8::1"
# CONFIG_NET_CONFIG_PEER_IPV6_ADDR="2001:db8::2"

# Убирает задержку в состоянии TIME_WAIT для закрывающихся TCP-соединений.
CONFIG_NET_TCP_TIME_WAIT_DELAY=0

# Ограничение максимального числа одновременных сетевых контекстов и TCP-соединений до 10.
# Предотвращает перерасход оперативной памяти
CONFIG_NET_MAX_CONTEXTS=10
CONFIG_NET_MAX_CONN=10

# Подсистема управления сетью и генерации событий.
# Позволяет коду приложения отслеживать системные события (например, «линк поднят», «IP получен») через колбэки.
CONFIG_NET_MGMT=y
CONFIG_NET_MGMT_EVENT=y


# General config
# Требует подключения полной стандартной библиотеки языка C (а не урезанной мини-версии вроде picolibc).
# Необходима для корректной работы сторонних библиотек и сложных алгоритмов обработки данных.
CONFIG_REQUIRES_FULL_LIBC=y
# Подсистема ввода (кнопки, датчики).
CONFIG_INPUT=y
# Включает шину SPI (используется для дисплеев или камер).
CONFIG_SPI=y
# Базовый контроль портов ввода-вывода (управление пинами).
CONFIG_GPIO=y
# CONFIG_LED=y

# Подсистема захвата и обработки видео (работа с камерами, фреймбуферами).
CONFIG_VIDEO=y
# Подсистема вывода графики на экран дисплея.
CONFIG_DISPLAY=y
# Включает UART/USB консоль для управления устройствами.
CONFIG_DEVICE_SHELL=y

# Включает быстрый вывод сообщений ядра в консоль.
CONFIG_PRINTK=y
# Включает поддержку вывода чисел с плавающей точкой (float/double) в функциях форматированного вывода (printk/printf).
CONFIG_CBPRINTF_FP_SUPPORT=y
# Гарантирует поддержку вывода float на уровне глобального форматирования.
CONFIG_REQUIRES_FLOAT_PRINTF=y

# Подключить API обёртку для POSIX (Portable Operating System Interface) стандарта.
CONFIG_POSIX_API=y
# Event File Descriptors - включает поддержку механизма POSIX-совместимого способа уведомления о событиях через файловые дескриптор.
CONFIG_EVENTFD=y

# ZVFS (Zephyr Virtual Filesystem) - мост между Zephyr и стандартами POSIX/C для работы с файлами, сокетами и устройствами.
# Значение 32 означает, что можно одновременно опрашивать до 32 сокетов или других файловых дескрипторов. 
CONFIG_ZVFS_POLL_MAX=32
# Максимальное количество событий для сетевых подсистем (HTTP-сервер, CoAP-сервер, LwM2M, PTP, SSH, socket service) .
CONFIG_ZVFS_EVENTFD_MAX=4
# Дополнительное количество слотов для открытых файловых дескрипторов для обработки одновременных клиентских соединений.
CONFIG_ZVFS_OPEN_ADD_SIZE_NET_SAMPLE=24


# Включение алгоритма хеширования SHA-1 в криптографическом бэкенде mbedTLS (через стандартизированный API PSA Crypto).
# Протокол WebSocket на этапе рукопожатия (Sec-WebSocket-Accept) требует обязательного вычисления хеша SHA-1 от специального ключа клиента.
CONFIG_PSA_WANT_ALG_SHA_1=y
CONFIG_MBEDTLS_SHA1=y



# ==========================================================================
# Включает подсистему дисплея Zephyr, именно через эту подсистему LVGL получает доступ к дисплею.
CONFIG_DISPLAY=y
# В отложенном режиме сообщения в подсистеме логирования не выводятся немедленно, а помещаются в буфер и обрабатываются фоновым потоком.
CONFIG_LOG_MODE_DEFERRED=y
# Задаёт размер системной кучи ядра Zephyr в байтах. Драйверы (дисплея и input) используют динамическое выделение памяти под буферы.
CONFIG_HEAP_MEM_POOL_SIZE=46144

# Включает драйвер резистивного тачскрина XPT2046. Драйвер работает через шину SPI и создаёт устройство ввода в подсистеме input.
CONFIG_INPUT_XPT2046=y
# Включает поддержку шины SPI на уровне драйверов Zephyr. SPI необходим для работы дисплея и сенсорной панели.
CONFIG_SPI=y
# Включает подсистему GPIO Zephyr. Нужна для управления пинами (сброс дисплея, прерывание тачскрина, подсветка)
CONFIG_GPIO=y

# Устанавливает уровень логирования для подсистемы input на DBG (debug). Это самый подробный уровень - выводятся все отладочные сообщения.
# CONFIG_INPUT_LOG_LEVEL_DBG=y

# # Включает графическую библиотеку LVGL как модуль Zephyr. 
# CONFIG_LVGL=y
# # Задаёт глубину цвета LVGL - 16 бит на пиксель, формат RGB565 на ST7796.
# CONFIG_LV_COLOR_DEPTH_16=y

# # Включает подсистему ввода Zephyr. Это обязательное условие для работы любого драйвера ввода (включая XPT2046) и для связки с LVGL.
# CONFIG_INPUT=y
# # Включает мост между подсистемой input Zephyr и LVGL. Этот код слушает события от устройства ввода и преобразует их в lv_indev_data_t.
# CONFIG_LV_Z_POINTER_INPUT=y

# # Включает виджет slider (ползунок) в сборке LVGL.
# CONFIG_LV_USE_SLIDER=y
# # Модуль LVGL при инициализации находит устройство, на которое указывает zephyr,touch, и подписывается на его события. 
# CONFIG_LV_Z_POINTER_FROM_CHOSEN_TOUCH=y

# # Задаёт размер кучи, выделенной специально для LVGL, в байтах.
# CONFIG_LV_Z_MEM_POOL_SIZE=16384
# # Включает встроенную систему логирования LVGL.
# CONFIG_LV_USE_LOG=y
# # Сообщает интеграционному слою LVGL/Zephyr, сколько бит на пиксель используется в буферах дисплея.
# CONFIG_LV_Z_BITS_PER_PIXEL=16
# # Выполняет байтовый своп для 16-битных цветов RGB565. Без свопа вы увидите инвертированные цвета.
# CONFIG_LV_COLOR_16_SWAP=y


# Включает библиотеку libmpix — легковесную библиотеку для обработки пиксельных данных на микроконтроллерах.
CONFIG_MPIX=y

# Включаем поддержку C++.
CONFIG_CPP=y
# Выбираем стандарт C++17 для исходников TFLM.
CONFIG_STD_CPP17=y
# Требуем полноценную реализацию стандартной C-библиотеки.
CONFIG_REQUIRES_FULL_LIBC=y
# Включаем TensorFlow Lite Micro.
CONFIG_TENSORFLOW_LITE_MICRO=y
```

## src/det_postprocess.h
```c
/*
 * det_postprocess.h - постпроцессинг детектора (SSD / TTF) для TFLM-int8 моделей.
 * Без динамической памяти, без libm кроме expf/logf. Конфигурация — в detector_config.h
 * (генерируется ноутбуком TFL-Detection.ipynb вместе с model.hpp).
 */
#ifndef DET_POSTPROCESS_H_
#define DET_POSTPROCESS_H_

#include <stdint.h>

#ifdef __cplusplus
extern "C" {
#endif

/* Результат детекции: координаты нормированы в [0,1] относительно входного кадра (x вправо, y вниз). */
typedef struct {
	float x1, y1, x2, y2;
	float score;
	int   label;      /* 0-based индекс переднего плана: DET_LABELS[label] */
} det_t;

/* int8-тензор модели вместе с параметрами квантования (output->data.int8, params.scale, params.zero_point). */
typedef struct {
	const int8_t *data;
	float         scale;
	int           zero_point;
} det_tensor_t;

/*
 * SSD: cls = логиты [DET_NUM_ANCHORS][DET_NUM_CLASSES+1] (индекс 0 - фон), box = дельты [DET_NUM_ANCHORS][4].
 * TTF: cls = heatmap-логиты [H][W][DET_NUM_CLASSES],       box = ltrb      [H][W][4] (доли кадра, >=0).
 * Возвращает число детекций (<= max_out), отсортированных по убыванию score.
 */
int det_postprocess(const det_tensor_t *cls, const det_tensor_t *box, det_t *out, int max_out);

#ifdef __cplusplus
}
#endif

#endif /* DET_POSTPROCESS_H_ */
```

## src/detector_config.h
```c
/* автогенерация TFL-Detection.ipynb - не править вручную */
#ifndef DETECTOR_CONFIG_H_
#define DETECTOR_CONFIG_H_

#define DET_ARCH_SSD 1
#define DET_ARCH_TTF 2
#define DET_ARCH DET_ARCH_SSD

#define DET_NUM_CLASSES 2
#define DET_INPUT_W 32
#define DET_INPUT_H 32
#define DET_INPUT_SCALE 0.00392156886f
#define DET_INPUT_ZERO_POINT -128
/*  квантование входа: q = clamp(round(pix/255/DET_INPUT_SCALE) + DET_INPUT_ZERO_POINT, -128, 127) */

/* индексы выходных тензоров интерпретатора: interpreter->output(i) */
#define DET_OUT_CLS_IDX 0
#define DET_OUT_BOX_IDX 1

#define DET_CONF_THR 0.5000f
#define DET_NMS_IOU 0.4500f
#define DET_PRE_NMS_TOPK 64
#define DET_MAX_DET 10

static const char *const DET_LABELS[DET_NUM_CLASSES] = {"matrjona", "mouse"};

#define DET_NUM_ANCHORS 320
static const float DET_VAR[4] = {0.1f, 0.1f, 0.2f, 0.2f};
/* anchors: cx, cy, w, h в долях кадра; порядок (строка, столбец, anchor), уровни подряд */
static const float DET_ANCHORS[DET_NUM_ANCHORS][4] = {
  {0.0625f, 0.0625f, 0.34375f, 0.5625f},
  {0.0625f, 0.0625f, 0.46875f, 0.4375f},
  {0.0625f, 0.0625f, 0.4375f, 0.71875f},
  {0.0625f, 0.0625f, 0.59375f, 0.625f},
  {0.1875f, 0.0625f, 0.34375f, 0.5625f},
  {0.1875f, 0.0625f, 0.46875f, 0.4375f},
  {0.1875f, 0.0625f, 0.4375f, 0.71875f},
  {0.1875f, 0.0625f, 0.59375f, 0.625f},
  {0.3125f, 0.0625f, 0.34375f, 0.5625f},
  {0.3125f, 0.0625f, 0.46875f, 0.4375f},
  {0.3125f, 0.0625f, 0.4375f, 0.71875f},
  {0.3125f, 0.0625f, 0.59375f, 0.625f},
  {0.4375f, 0.0625f, 0.34375f, 0.5625f},
  {0.4375f, 0.0625f, 0.46875f, 0.4375f},
  {0.4375f, 0.0625f, 0.4375f, 0.71875f},
  {0.4375f, 0.0625f, 0.59375f, 0.625f},
  {0.5625f, 0.0625f, 0.34375f, 0.5625f},
  {0.5625f, 0.0625f, 0.46875f, 0.4375f},
  {0.5625f, 0.0625f, 0.4375f, 0.71875f},
  {0.5625f, 0.0625f, 0.59375f, 0.625f},
  {0.6875f, 0.0625f, 0.34375f, 0.5625f},
  {0.6875f, 0.0625f, 0.46875f, 0.4375f},
  {0.6875f, 0.0625f, 0.4375f, 0.71875f},
  {0.6875f, 0.0625f, 0.59375f, 0.625f},
  {0.8125f, 0.0625f, 0.34375f, 0.5625f},
  {0.8125f, 0.0625f, 0.46875f, 0.4375f},
  {0.8125f, 0.0625f, 0.4375f, 0.71875f},
  {0.8125f, 0.0625f, 0.59375f, 0.625f},
  {0.9375f, 0.0625f, 0.34375f, 0.5625f},
  {0.9375f, 0.0625f, 0.46875f, 0.4375f},
  {0.9375f, 0.0625f, 0.4375f, 0.71875f},
  {0.9375f, 0.0625f, 0.59375f, 0.625f},
  {0.0625f, 0.1875f, 0.34375f, 0.5625f},
  {0.0625f, 0.1875f, 0.46875f, 0.4375f},
  {0.0625f, 0.1875f, 0.4375f, 0.71875f},
  {0.0625f, 0.1875f, 0.59375f, 0.625f},
  {0.1875f, 0.1875f, 0.34375f, 0.5625f},
  {0.1875f, 0.1875f, 0.46875f, 0.4375f},
  {0.1875f, 0.1875f, 0.4375f, 0.71875f},
  {0.1875f, 0.1875f, 0.59375f, 0.625f},
  {0.3125f, 0.1875f, 0.34375f, 0.5625f},
  {0.3125f, 0.1875f, 0.46875f, 0.4375f},
  {0.3125f, 0.1875f, 0.4375f, 0.71875f},
  {0.3125f, 0.1875f, 0.59375f, 0.625f},
  {0.4375f, 0.1875f, 0.34375f, 0.5625f},
  {0.4375f, 0.1875f, 0.46875f, 0.4375f},
  {0.4375f, 0.1875f, 0.4375f, 0.71875f},
  {0.4375f, 0.1875f, 0.59375f, 0.625f},
  {0.5625f, 0.1875f, 0.34375f, 0.5625f},
  {0.5625f, 0.1875f, 0.46875f, 0.4375f},
  {0.5625f, 0.1875f, 0.4375f, 0.71875f},
  {0.5625f, 0.1875f, 0.59375f, 0.625f},
  {0.6875f, 0.1875f, 0.34375f, 0.5625f},
  {0.6875f, 0.1875f, 0.46875f, 0.4375f},
  {0.6875f, 0.1875f, 0.4375f, 0.71875f},
  {0.6875f, 0.1875f, 0.59375f, 0.625f},
  {0.8125f, 0.1875f, 0.34375f, 0.5625f},
  {0.8125f, 0.1875f, 0.46875f, 0.4375f},
  {0.8125f, 0.1875f, 0.4375f, 0.71875f},
  {0.8125f, 0.1875f, 0.59375f, 0.625f},
  {0.9375f, 0.1875f, 0.34375f, 0.5625f},
  {0.9375f, 0.1875f, 0.46875f, 0.4375f},
  {0.9375f, 0.1875f, 0.4375f, 0.71875f},
  {0.9375f, 0.1875f, 0.59375f, 0.625f},
  {0.0625f, 0.3125f, 0.34375f, 0.5625f},
  {0.0625f, 0.3125f, 0.46875f, 0.4375f},
  {0.0625f, 0.3125f, 0.4375f, 0.71875f},
  {0.0625f, 0.3125f, 0.59375f, 0.625f},
  {0.1875f, 0.3125f, 0.34375f, 0.5625f},
  {0.1875f, 0.3125f, 0.46875f, 0.4375f},
  {0.1875f, 0.3125f, 0.4375f, 0.71875f},
  {0.1875f, 0.3125f, 0.59375f, 0.625f},
  {0.3125f, 0.3125f, 0.34375f, 0.5625f},
  {0.3125f, 0.3125f, 0.46875f, 0.4375f},
  {0.3125f, 0.3125f, 0.4375f, 0.71875f},
  {0.3125f, 0.3125f, 0.59375f, 0.625f},
  {0.4375f, 0.3125f, 0.34375f, 0.5625f},
  {0.4375f, 0.3125f, 0.46875f, 0.4375f},
  {0.4375f, 0.3125f, 0.4375f, 0.71875f},
  {0.4375f, 0.3125f, 0.59375f, 0.625f},
  {0.5625f, 0.3125f, 0.34375f, 0.5625f},
  {0.5625f, 0.3125f, 0.46875f, 0.4375f},
  {0.5625f, 0.3125f, 0.4375f, 0.71875f},
  {0.5625f, 0.3125f, 0.59375f, 0.625f},
  {0.6875f, 0.3125f, 0.34375f, 0.5625f},
  {0.6875f, 0.3125f, 0.46875f, 0.4375f},
  {0.6875f, 0.3125f, 0.4375f, 0.71875f},
  {0.6875f, 0.3125f, 0.59375f, 0.625f},
  {0.8125f, 0.3125f, 0.34375f, 0.5625f},
  {0.8125f, 0.3125f, 0.46875f, 0.4375f},
  {0.8125f, 0.3125f, 0.4375f, 0.71875f},
  {0.8125f, 0.3125f, 0.59375f, 0.625f},
  {0.9375f, 0.3125f, 0.34375f, 0.5625f},
  {0.9375f, 0.3125f, 0.46875f, 0.4375f},
  {0.9375f, 0.3125f, 0.4375f, 0.71875f},
  {0.9375f, 0.3125f, 0.59375f, 0.625f},
  {0.0625f, 0.4375f, 0.34375f, 0.5625f},
  {0.0625f, 0.4375f, 0.46875f, 0.4375f},
  {0.0625f, 0.4375f, 0.4375f, 0.71875f},
  {0.0625f, 0.4375f, 0.59375f, 0.625f},
  {0.1875f, 0.4375f, 0.34375f, 0.5625f},
  {0.1875f, 0.4375f, 0.46875f, 0.4375f},
  {0.1875f, 0.4375f, 0.4375f, 0.71875f},
  {0.1875f, 0.4375f, 0.59375f, 0.625f},
  {0.3125f, 0.4375f, 0.34375f, 0.5625f},
  {0.3125f, 0.4375f, 0.46875f, 0.4375f},
  {0.3125f, 0.4375f, 0.4375f, 0.71875f},
  {0.3125f, 0.4375f, 0.59375f, 0.625f},
  {0.4375f, 0.4375f, 0.34375f, 0.5625f},
  {0.4375f, 0.4375f, 0.46875f, 0.4375f},
  {0.4375f, 0.4375f, 0.4375f, 0.71875f},
  {0.4375f, 0.4375f, 0.59375f, 0.625f},
  {0.5625f, 0.4375f, 0.34375f, 0.5625f},
  {0.5625f, 0.4375f, 0.46875f, 0.4375f},
  {0.5625f, 0.4375f, 0.4375f, 0.71875f},
  {0.5625f, 0.4375f, 0.59375f, 0.625f},
  {0.6875f, 0.4375f, 0.34375f, 0.5625f},
  {0.6875f, 0.4375f, 0.46875f, 0.4375f},
  {0.6875f, 0.4375f, 0.4375f, 0.71875f},
  {0.6875f, 0.4375f, 0.59375f, 0.625f},
  {0.8125f, 0.4375f, 0.34375f, 0.5625f},
  {0.8125f, 0.4375f, 0.46875f, 0.4375f},
  {0.8125f, 0.4375f, 0.4375f, 0.71875f},
  {0.8125f, 0.4375f, 0.59375f, 0.625f},
  {0.9375f, 0.4375f, 0.34375f, 0.5625f},
  {0.9375f, 0.4375f, 0.46875f, 0.4375f},
  {0.9375f, 0.4375f, 0.4375f, 0.71875f},
  {0.9375f, 0.4375f, 0.59375f, 0.625f},
  {0.0625f, 0.5625f, 0.34375f, 0.5625f},
  {0.0625f, 0.5625f, 0.46875f, 0.4375f},
  {0.0625f, 0.5625f, 0.4375f, 0.71875f},
  {0.0625f, 0.5625f, 0.59375f, 0.625f},
  {0.1875f, 0.5625f, 0.34375f, 0.5625f},
  {0.1875f, 0.5625f, 0.46875f, 0.4375f},
  {0.1875f, 0.5625f, 0.4375f, 0.71875f},
  {0.1875f, 0.5625f, 0.59375f, 0.625f},
  {0.3125f, 0.5625f, 0.34375f, 0.5625f},
  {0.3125f, 0.5625f, 0.46875f, 0.4375f},
  {0.3125f, 0.5625f, 0.4375f, 0.71875f},
  {0.3125f, 0.5625f, 0.59375f, 0.625f},
  {0.4375f, 0.5625f, 0.34375f, 0.5625f},
  {0.4375f, 0.5625f, 0.46875f, 0.4375f},
  {0.4375f, 0.5625f, 0.4375f, 0.71875f},
  {0.4375f, 0.5625f, 0.59375f, 0.625f},
  {0.5625f, 0.5625f, 0.34375f, 0.5625f},
  {0.5625f, 0.5625f, 0.46875f, 0.4375f},
  {0.5625f, 0.5625f, 0.4375f, 0.71875f},
  {0.5625f, 0.5625f, 0.59375f, 0.625f},
  {0.6875f, 0.5625f, 0.34375f, 0.5625f},
  {0.6875f, 0.5625f, 0.46875f, 0.4375f},
  {0.6875f, 0.5625f, 0.4375f, 0.71875f},
  {0.6875f, 0.5625f, 0.59375f, 0.625f},
  {0.8125f, 0.5625f, 0.34375f, 0.5625f},
  {0.8125f, 0.5625f, 0.46875f, 0.4375f},
  {0.8125f, 0.5625f, 0.4375f, 0.71875f},
  {0.8125f, 0.5625f, 0.59375f, 0.625f},
  {0.9375f, 0.5625f, 0.34375f, 0.5625f},
  {0.9375f, 0.5625f, 0.46875f, 0.4375f},
  {0.9375f, 0.5625f, 0.4375f, 0.71875f},
  {0.9375f, 0.5625f, 0.59375f, 0.625f},
  {0.0625f, 0.6875f, 0.34375f, 0.5625f},
  {0.0625f, 0.6875f, 0.46875f, 0.4375f},
  {0.0625f, 0.6875f, 0.4375f, 0.71875f},
  {0.0625f, 0.6875f, 0.59375f, 0.625f},
  {0.1875f, 0.6875f, 0.34375f, 0.5625f},
  {0.1875f, 0.6875f, 0.46875f, 0.4375f},
  {0.1875f, 0.6875f, 0.4375f, 0.71875f},
  {0.1875f, 0.6875f, 0.59375f, 0.625f},
  {0.3125f, 0.6875f, 0.34375f, 0.5625f},
  {0.3125f, 0.6875f, 0.46875f, 0.4375f},
  {0.3125f, 0.6875f, 0.4375f, 0.71875f},
  {0.3125f, 0.6875f, 0.59375f, 0.625f},
  {0.4375f, 0.6875f, 0.34375f, 0.5625f},
  {0.4375f, 0.6875f, 0.46875f, 0.4375f},
  {0.4375f, 0.6875f, 0.4375f, 0.71875f},
  {0.4375f, 0.6875f, 0.59375f, 0.625f},
  {0.5625f, 0.6875f, 0.34375f, 0.5625f},
  {0.5625f, 0.6875f, 0.46875f, 0.4375f},
  {0.5625f, 0.6875f, 0.4375f, 0.71875f},
  {0.5625f, 0.6875f, 0.59375f, 0.625f},
  {0.6875f, 0.6875f, 0.34375f, 0.5625f},
  {0.6875f, 0.6875f, 0.46875f, 0.4375f},
  {0.6875f, 0.6875f, 0.4375f, 0.71875f},
  {0.6875f, 0.6875f, 0.59375f, 0.625f},
  {0.8125f, 0.6875f, 0.34375f, 0.5625f},
  {0.8125f, 0.6875f, 0.46875f, 0.4375f},
  {0.8125f, 0.6875f, 0.4375f, 0.71875f},
  {0.8125f, 0.6875f, 0.59375f, 0.625f},
  {0.9375f, 0.6875f, 0.34375f, 0.5625f},
  {0.9375f, 0.6875f, 0.46875f, 0.4375f},
  {0.9375f, 0.6875f, 0.4375f, 0.71875f},
  {0.9375f, 0.6875f, 0.59375f, 0.625f},
  {0.0625f, 0.8125f, 0.34375f, 0.5625f},
  {0.0625f, 0.8125f, 0.46875f, 0.4375f},
  {0.0625f, 0.8125f, 0.4375f, 0.71875f},
  {0.0625f, 0.8125f, 0.59375f, 0.625f},
  {0.1875f, 0.8125f, 0.34375f, 0.5625f},
  {0.1875f, 0.8125f, 0.46875f, 0.4375f},
  {0.1875f, 0.8125f, 0.4375f, 0.71875f},
  {0.1875f, 0.8125f, 0.59375f, 0.625f},
  {0.3125f, 0.8125f, 0.34375f, 0.5625f},
  {0.3125f, 0.8125f, 0.46875f, 0.4375f},
  {0.3125f, 0.8125f, 0.4375f, 0.71875f},
  {0.3125f, 0.8125f, 0.59375f, 0.625f},
  {0.4375f, 0.8125f, 0.34375f, 0.5625f},
  {0.4375f, 0.8125f, 0.46875f, 0.4375f},
  {0.4375f, 0.8125f, 0.4375f, 0.71875f},
  {0.4375f, 0.8125f, 0.59375f, 0.625f},
  {0.5625f, 0.8125f, 0.34375f, 0.5625f},
  {0.5625f, 0.8125f, 0.46875f, 0.4375f},
  {0.5625f, 0.8125f, 0.4375f, 0.71875f},
  {0.5625f, 0.8125f, 0.59375f, 0.625f},
  {0.6875f, 0.8125f, 0.34375f, 0.5625f},
  {0.6875f, 0.8125f, 0.46875f, 0.4375f},
  {0.6875f, 0.8125f, 0.4375f, 0.71875f},
  {0.6875f, 0.8125f, 0.59375f, 0.625f},
  {0.8125f, 0.8125f, 0.34375f, 0.5625f},
  {0.8125f, 0.8125f, 0.46875f, 0.4375f},
  {0.8125f, 0.8125f, 0.4375f, 0.71875f},
  {0.8125f, 0.8125f, 0.59375f, 0.625f},
  {0.9375f, 0.8125f, 0.34375f, 0.5625f},
  {0.9375f, 0.8125f, 0.46875f, 0.4375f},
  {0.9375f, 0.8125f, 0.4375f, 0.71875f},
  {0.9375f, 0.8125f, 0.59375f, 0.625f},
  {0.0625f, 0.9375f, 0.34375f, 0.5625f},
  {0.0625f, 0.9375f, 0.46875f, 0.4375f},
  {0.0625f, 0.9375f, 0.4375f, 0.71875f},
  {0.0625f, 0.9375f, 0.59375f, 0.625f},
  {0.1875f, 0.9375f, 0.34375f, 0.5625f},
  {0.1875f, 0.9375f, 0.46875f, 0.4375f},
  {0.1875f, 0.9375f, 0.4375f, 0.71875f},
  {0.1875f, 0.9375f, 0.59375f, 0.625f},
  {0.3125f, 0.9375f, 0.34375f, 0.5625f},
  {0.3125f, 0.9375f, 0.46875f, 0.4375f},
  {0.3125f, 0.9375f, 0.4375f, 0.71875f},
  {0.3125f, 0.9375f, 0.59375f, 0.625f},
  {0.4375f, 0.9375f, 0.34375f, 0.5625f},
  {0.4375f, 0.9375f, 0.46875f, 0.4375f},
  {0.4375f, 0.9375f, 0.4375f, 0.71875f},
  {0.4375f, 0.9375f, 0.59375f, 0.625f},
  {0.5625f, 0.9375f, 0.34375f, 0.5625f},
  {0.5625f, 0.9375f, 0.46875f, 0.4375f},
  {0.5625f, 0.9375f, 0.4375f, 0.71875f},
  {0.5625f, 0.9375f, 0.59375f, 0.625f},
  {0.6875f, 0.9375f, 0.34375f, 0.5625f},
  {0.6875f, 0.9375f, 0.46875f, 0.4375f},
  {0.6875f, 0.9375f, 0.4375f, 0.71875f},
  {0.6875f, 0.9375f, 0.59375f, 0.625f},
  {0.8125f, 0.9375f, 0.34375f, 0.5625f},
  {0.8125f, 0.9375f, 0.46875f, 0.4375f},
  {0.8125f, 0.9375f, 0.4375f, 0.71875f},
  {0.8125f, 0.9375f, 0.59375f, 0.625f},
  {0.9375f, 0.9375f, 0.34375f, 0.5625f},
  {0.9375f, 0.9375f, 0.46875f, 0.4375f},
  {0.9375f, 0.9375f, 0.4375f, 0.71875f},
  {0.9375f, 0.9375f, 0.59375f, 0.625f},
  {0.125f, 0.125f, 0.4375f, 0.71875f},
  {0.125f, 0.125f, 0.59375f, 0.625f},
  {0.125f, 0.125f, 0.6875f, 0.78125f},
  {0.125f, 0.125f, 0.59375f, 0.90625f},
  {0.375f, 0.125f, 0.4375f, 0.71875f},
  {0.375f, 0.125f, 0.59375f, 0.625f},
  {0.375f, 0.125f, 0.6875f, 0.78125f},
  {0.375f, 0.125f, 0.59375f, 0.90625f},
  {0.625f, 0.125f, 0.4375f, 0.71875f},
  {0.625f, 0.125f, 0.59375f, 0.625f},
  {0.625f, 0.125f, 0.6875f, 0.78125f},
  {0.625f, 0.125f, 0.59375f, 0.90625f},
  {0.875f, 0.125f, 0.4375f, 0.71875f},
  {0.875f, 0.125f, 0.59375f, 0.625f},
  {0.875f, 0.125f, 0.6875f, 0.78125f},
  {0.875f, 0.125f, 0.59375f, 0.90625f},
  {0.125f, 0.375f, 0.4375f, 0.71875f},
  {0.125f, 0.375f, 0.59375f, 0.625f},
  {0.125f, 0.375f, 0.6875f, 0.78125f},
  {0.125f, 0.375f, 0.59375f, 0.90625f},
  {0.375f, 0.375f, 0.4375f, 0.71875f},
  {0.375f, 0.375f, 0.59375f, 0.625f},
  {0.375f, 0.375f, 0.6875f, 0.78125f},
  {0.375f, 0.375f, 0.59375f, 0.90625f},
  {0.625f, 0.375f, 0.4375f, 0.71875f},
  {0.625f, 0.375f, 0.59375f, 0.625f},
  {0.625f, 0.375f, 0.6875f, 0.78125f},
  {0.625f, 0.375f, 0.59375f, 0.90625f},
  {0.875f, 0.375f, 0.4375f, 0.71875f},
  {0.875f, 0.375f, 0.59375f, 0.625f},
  {0.875f, 0.375f, 0.6875f, 0.78125f},
  {0.875f, 0.375f, 0.59375f, 0.90625f},
  {0.125f, 0.625f, 0.4375f, 0.71875f},
  {0.125f, 0.625f, 0.59375f, 0.625f},
  {0.125f, 0.625f, 0.6875f, 0.78125f},
  {0.125f, 0.625f, 0.59375f, 0.90625f},
  {0.375f, 0.625f, 0.4375f, 0.71875f},
  {0.375f, 0.625f, 0.59375f, 0.625f},
  {0.375f, 0.625f, 0.6875f, 0.78125f},
  {0.375f, 0.625f, 0.59375f, 0.90625f},
  {0.625f, 0.625f, 0.4375f, 0.71875f},
  {0.625f, 0.625f, 0.59375f, 0.625f},
  {0.625f, 0.625f, 0.6875f, 0.78125f},
  {0.625f, 0.625f, 0.59375f, 0.90625f},
  {0.875f, 0.625f, 0.4375f, 0.71875f},
  {0.875f, 0.625f, 0.59375f, 0.625f},
  {0.875f, 0.625f, 0.6875f, 0.78125f},
  {0.875f, 0.625f, 0.59375f, 0.90625f},
  {0.125f, 0.875f, 0.4375f, 0.71875f},
  {0.125f, 0.875f, 0.59375f, 0.625f},
  {0.125f, 0.875f, 0.6875f, 0.78125f},
  {0.125f, 0.875f, 0.59375f, 0.90625f},
  {0.375f, 0.875f, 0.4375f, 0.71875f},
  {0.375f, 0.875f, 0.59375f, 0.625f},
  {0.375f, 0.875f, 0.6875f, 0.78125f},
  {0.375f, 0.875f, 0.59375f, 0.90625f},
  {0.625f, 0.875f, 0.4375f, 0.71875f},
  {0.625f, 0.875f, 0.59375f, 0.625f},
  {0.625f, 0.875f, 0.6875f, 0.78125f},
  {0.625f, 0.875f, 0.59375f, 0.90625f},
  {0.875f, 0.875f, 0.4375f, 0.71875f},
  {0.875f, 0.875f, 0.59375f, 0.625f},
  {0.875f, 0.875f, 0.6875f, 0.78125f},
  {0.875f, 0.875f, 0.59375f, 0.90625f},
};

#endif /* DETECTOR_CONFIG_H_ */
```

## src/tflm_wrapper.cpp
```c
#include "tflm_wrapper.h"

#include <cmath>
#include <cstdint>

#include <zephyr/kernel.h>
#include <zephyr/toolchain.h>

#include <tensorflow/lite/micro/micro_mutable_op_resolver.h>
#include <tensorflow/lite/micro/micro_log.h>
#include <tensorflow/lite/micro/micro_interpreter.h>
#include <tensorflow/lite/micro/system_setup.h>
#include <tensorflow/lite/schema/schema_generated.h>

#include "model.hpp"            /* g_model - модель, сгенерированная custom_ssd_v3.ipynb */
#include "detector_config.h"    /* DET_ARCH, DET_NUM_ANCHORS, DET_OUT_*_IDX, DET_INPUT_* ... */

/* Защита от рассинхронизации: model.hpp / detector_config.h / tflm_wrapper.h должны быть из одного запуска ноутбука. */
static_assert(DET_NUM_CLASSES == TFLM_NUM_CLASSES, "detector_config.h: число классов != TFLM_NUM_CLASSES");
static_assert(DET_INPUT_W == TFLM_INPUT_W && DET_INPUT_H == TFLM_INPUT_H, "detector_config.h: размер входа != TFLM_INPUT_*");
static_assert(DET_OUT_CLS_IDX != DET_OUT_BOX_IDX, "detector_config.h: индексы выходов совпадают");

namespace {

const tflite::Model *model = nullptr;
tflite::MicroInterpreter *interpreter = nullptr;
TfLiteTensor *input = nullptr;
TfLiteTensor *out_cls = nullptr;   /* SSD: cls_logits [A][NC+1]  | TTF: heatmap-логиты [H][W][NC] */
TfLiteTensor *out_box = nullptr;   /* SSD: box_deltas [A][4]     | TTF: ltrb          [H][W][4]  */
bool ready = false;

/* Арена тензоров. Пик задаёт первая свёртка backbone (вход 3 КБ + выход 16 КБ) плюс удерживаемая карта 8x8x64
 * для FPN. Начинаем с 40 КБ; смотрите лог "arena used" и уменьшайте (допустимый потолок проекта - 100 КБ).
 * Арена лежит во ВНУТРЕННЕЙ SRAM (быстрее PSRAM). */
constexpr int kTensorArenaSize = 31 * 1024;

uint8_t tensor_arena[kTensorArenaSize]
	__attribute__((aligned(16)));

/* LUT квантования входа: uint8 пиксель -> int8. Строится по ФАКТИЧЕСКИМ параметрам входного тензора:
 * q = clamp(round(pix/255/scale) + zero_point). При scale=1/255, zp=-128 это ровно (pix - 128). */
int8_t input_lut[256];

uint32_t last_invoke_us = 0;
uint32_t last_post_us = 0;

/* Наименования классов (порядок = порядок fg_classes в ноутбуке: matrjona, mouse). */
// const char *const kCategoryLabels[TFLM_NUM_CLASSES] = {"Matrjona", "Mouse"};
const char *const kCategoryLabels[TFLM_NUM_CLASSES] = {"Матрёшка", "Мышка"};

#if DET_ARCH == DET_ARCH_SSD
constexpr size_t kClsBytes = (size_t)DET_NUM_ANCHORS * (DET_NUM_CLASSES + 1);
constexpr size_t kBoxBytes = (size_t)DET_NUM_ANCHORS * 4;
#else
constexpr size_t kClsBytes = (size_t)DET_GRID_H * DET_GRID_W * DET_NUM_CLASSES;
constexpr size_t kBoxBytes = (size_t)DET_GRID_H * DET_GRID_W * 4;
#endif

} /* namespace */

extern "C" const char *tflm_wrapper_label(int idx)
{
	if (idx < 0 || idx >= TFLM_NUM_CLASSES) {
		return "?";
	}
	return kCategoryLabels[idx];
}

extern "C" void tflm_wrapper_get_timing(uint32_t *invoke_us, uint32_t *post_us)
{
	if (invoke_us) { *invoke_us = last_invoke_us; }
	if (post_us)   { *post_us = last_post_us; }
}

extern "C" int tflm_wrapper_init(void)
{
	model = tflite::GetModel(g_model);
	if (model->version() != TFLITE_SCHEMA_VERSION) {
		MicroPrintf("Model schema version %d != supported %d",
			    (int)model->version(), TFLITE_SCHEMA_VERSION);
		return -1;
	}

	/* Операции детектора (список печатает ноутбук в разделе 'Экспорт'). */
	static tflite::MicroMutableOpResolver<7> micro_op_resolver;
	if (micro_op_resolver.AddAdd() != kTfLiteOk ||
	    micro_op_resolver.AddConcatenation() != kTfLiteOk ||
	    micro_op_resolver.AddConv2D() != kTfLiteOk ||
	    micro_op_resolver.AddDepthwiseConv2D() != kTfLiteOk ||
	    micro_op_resolver.AddMaxPool2D() != kTfLiteOk ||
	    micro_op_resolver.AddReshape() != kTfLiteOk ||
	    micro_op_resolver.AddResizeNearestNeighbor() != kTfLiteOk) {
		MicroPrintf("Op resolver: failed to register ops");
		return -5;
	}

	static tflite::MicroInterpreter static_interpreter(
		model, micro_op_resolver, tensor_arena, kTensorArenaSize);
	interpreter = &static_interpreter;

	if (interpreter->AllocateTensors() != kTfLiteOk) {
		MicroPrintf("AllocateTensors() failed (arena %d bytes)", kTensorArenaSize);
		return -2;
	}

	if (interpreter->inputs_size() != 1 || interpreter->outputs_size() != 2) {
		MicroPrintf("Bad model IO: %d inputs, %d outputs (expected 1/2)",
			    (int)interpreter->inputs_size(), (int)interpreter->outputs_size());
		return -3;
	}

	input = interpreter->input(0);
	out_cls = interpreter->output(DET_OUT_CLS_IDX);
	out_box = interpreter->output(DET_OUT_BOX_IDX);

	/* Проверки соответствия модели ожиданиям кода. */
	if (input->type != kTfLiteInt8 || input->bytes != (size_t)TFLM_INPUT_SIZE) {
		MicroPrintf("Bad input tensor: type %d, bytes %d", (int)input->type, (int)input->bytes);
		return -3;
	}
	if (out_cls->type != kTfLiteInt8 || out_cls->bytes != kClsBytes ||
	    out_box->type != kTfLiteInt8 || out_box->bytes != kBoxBytes) {
		MicroPrintf("Bad output tensors: cls %d B (exp %d), box %d B (exp %d). Проверьте DET_OUT_*_IDX и model.hpp",
			    (int)out_cls->bytes, (int)kClsBytes, (int)out_box->bytes, (int)kBoxBytes);
		return -4;
	}

	/* detector_config.h должен происходить из того же запуска ноутбука, что и model.hpp. */
	if (input->params.zero_point != DET_INPUT_ZERO_POINT ||
	    std::fabs(input->params.scale - DET_INPUT_SCALE) > 1e-6f) {
		MicroPrintf("WARNING: параметры входа модели (scale=%d/1e6, zp=%d) != detector_config.h - файлы из разных запусков?",
			    (int)(input->params.scale * 1e6f), (int)input->params.zero_point);
	}

	const float s = input->params.scale;
	const int zp = input->params.zero_point;
	for (int p = 0; p < 256; p++) {
		int q = (int)std::lround((float)p / 255.0f / s) + zp;
		input_lut[p] = (int8_t)(q < -128 ? -128 : (q > 127 ? 127 : q));
	}

	MicroPrintf("TFLM detector ready, arena used: %d of %d bytes",
		    (int)interpreter->arena_used_bytes(), kTensorArenaSize);

	ready = true;
	return 0;
}

extern "C" int tflm_wrapper_detect(const uint8_t *rgb, det_t *dets, int max_dets)
{
	if (!ready || rgb == nullptr || dets == nullptr || max_dets <= 0) {
		return -1;
	}

	/* uint8 [0..255] -> int8 по LUT. Порядок каналов R,G,B (как при обучении: вход модели = пиксель/255). */
	int8_t *dst = input->data.int8;
	for (int i = 0; i < TFLM_INPUT_SIZE; i++) {
		dst[i] = input_lut[rgb[i]];
	}

	const uint32_t t0 = k_cycle_get_32();
	if (interpreter->Invoke() != kTfLiteOk) {
		MicroPrintf("Invoke failed");
		return -2;
	}
	const uint32_t t1 = k_cycle_get_32();

	/* Сырые int8-выходы + параметры квантования -> декодирование анкеров/ltrb, порог, NMS (det_postprocess.c). */
	det_tensor_t cls = { out_cls->data.int8, out_cls->params.scale, out_cls->params.zero_point };
	det_tensor_t box = { out_box->data.int8, out_box->params.scale, out_box->params.zero_point };
	const int n = det_postprocess(&cls, &box, dets, max_dets);
	const uint32_t t2 = k_cycle_get_32();

	last_invoke_us = k_cyc_to_us_floor32(t1 - t0);
	last_post_us = k_cyc_to_us_floor32(t2 - t1);
	return n;
}
```

## src/tflm_wrapper.h
```c
#ifndef TFLM_WRAPPER_H
#define TFLM_WRAPPER_H

#include <stdint.h>

/* det_t (бокс + score + класс) и API постпроцессинга. Этот заголовок НЕ тянет detector_config.h,
 * поэтому безопасен для включения из нескольких .c/.cpp (таблица anchors не дублируется). */
#include "det_postprocess.h"

#ifdef __cplusplus
extern "C" {
#endif

/* Параметры входа модели (должны совпадать с custom_ssd_v3.ipynb; согласованность с detector_config.h
 * проверяется static_assert'ами в tflm_wrapper.cpp). Макросы, а не constexpr: используются в C-коде. */
#define TFLM_INPUT_W          32
#define TFLM_INPUT_H          32
#define TFLM_INPUT_C          3
#define TFLM_INPUT_SIZE       (TFLM_INPUT_W * TFLM_INPUT_H * TFLM_INPUT_C)
#define TFLM_NUM_CLASSES      2     /* без фона: Matrjona, Mouse */
#define TFLM_MAX_DETECTIONS   10    /* размер массива det_t в вызывающем коде */

/* Наименование класса по индексу переднего плана 0..TFLM_NUM_CLASSES-1 ("?" если вне диапазона). */
const char *tflm_wrapper_label(int idx);

/* Инициализация интерпретатора. 0 - успех, иначе отрицательный код.
 * Вызывать один раз, из того же потока, который потом вызывает detect. */
int tflm_wrapper_init(void);

/* Детекция на изображении 32x32 RGB24 (порядок R,G,B, значения 0..255).
 * Заполняет dets[] (до max_dets штук, по убыванию score), координаты в долях кадра [0..1].
 * Возвращает число детекций (>=0) либо отрицательный код ошибки. */
int tflm_wrapper_detect(const uint8_t *rgb, det_t *dets, int max_dets);

/* Время последнего вызова detect, мкс: чистый Invoke() и постпроцессинг (decode + NMS). */
void tflm_wrapper_get_timing(uint32_t *invoke_us, uint32_t *post_us);

#ifdef __cplusplus
}
#endif

#endif /* TFLM_WRAPPER_H */



















// #ifndef TFLM_WRAPPER_H
// #define TFLM_WRAPPER_H

// #include <stdint.h>

// #ifdef __cplusplus
// extern "C" {
// #endif

// /* Параметры входа/выхода модели (должны совпадать с обучением в TFL-Classification.ipynb).
//  * Макросы, а не constexpr: используются в C-коде (размеры массивов в thread_processing.c). */
// #define TFLM_INPUT_W       32
// #define TFLM_INPUT_H       32
// #define TFLM_INPUT_C       3
// #define TFLM_INPUT_SIZE    (TFLM_INPUT_W * TFLM_INPUT_H * TFLM_INPUT_C)
// #define TFLM_NUM_CLASSES   3

// /* Результат классификации. */
// struct tflm_result {
// 	/* Сырой выход модели (int8, -128..127), как в Arduino-проекте. */
// 	int8_t  raw[TFLM_NUM_CLASSES];
// 	/* Вероятность каждого класса в процентах, 0..100. */
// 	uint8_t percent[TFLM_NUM_CLASSES];
// 	/* Индекс класса с максимальной вероятностью. */
// 	int     best;
// };

// /* Наименование класса по индексу ("?" если индекс вне диапазона). */
// const char *tflm_wrapper_label(int idx);

// /* Инициализация интерпретатора. 0 - успех, иначе отрицательный код.
//  * Вызывать один раз, из того же потока, который потом вызывает classify. */
// int tflm_wrapper_init(void);

// /* Классификация изображения 32x32 RGB24 (порядок R,G,B, значения 0..255).
//  * Возвращает 0 при успехе. */
// int tflm_wrapper_classify(const uint8_t *rgb, struct tflm_result *res);

// #ifdef __cplusplus
// }
// #endif

// #endif /* TFLM_WRAPPER_H */
```

## src/thread_processing.c
```c
#include "tflm_wrapper.h"

#include <string.h>
#include <stdio.h>

#include <zephyr/kernel.h>
#include <zephyr/device.h>
#include <zephyr/cache.h>
#include <zephyr/sys/util.h>
#include <zephyr/drivers/display.h>
#include <zephyr/drivers/video.h>
#include <zephyr/logging/log.h>

#include <mpix/image.h>

#include "thread_processing.h"

// Логика работы с дисплеем (app_display_frame).
#include "display.h"
// Логика WebSocket-сервера (frame_is_sended, shared_frame_buf, allowed_2_send, shared_fmt ...).
#include "server.h"

// Подключим функции для обработки изображения.
#include "custom_mpix_draw.h"
#include "custom_mpix_font_12pt_rus.h"
#include "custom_mpix_font_freemonobold8pt_ru.h"

// Регистрирует отдельный модуль логирования.
LOG_MODULE_REGISTER(PROCESSING, LOG_LEVEL_INF);

/* Устройство дисплея определено в main.c. */
extern const struct device *const display_dev;
// Формат кадра (разрешение, pixelformat). Заполнится при инициализации камеры.
struct video_format shared_fmt;

/* Запускать детектор на каждом N-м кадре (1 = на каждом). Если инференс медленный, увеличьте значение:
 * между запусками на кадре рисуются последние найденные объекты. */
#define DETECT_EVERY_N_FRAMES 1

/* Отрисовка результата. */
#define BBOX_THICKNESS   2     /* толщина рамки, px */
#define LABEL_BASELINE   15    /* отступ базовой линии шрифта 12pt от верхнего края строки, px */
#define LABEL_CHAR_W     14    /* ширина символа моноширинного шрифта, px (подстройте под ваш шрифт) */
#define SHOW_STATS       1     /* 1 = внизу кадра печатать "N obj, X ms" */

/* Цвет рамки по классу. Макрос, а не массив: тип CUSTOM_MPIX_COLOR_* определён в custom_mpix_draw.h. */
#define DET_COLOR(label) (((label) % 2) == 0 ? CUSTOM_MPIX_COLOR_YELLOW : CUSTOM_MPIX_COLOR_RED)

/* ------------------------------------------------------------------------------------------------- */
/*                                      Общие данные потока                                           */
/* ------------------------------------------------------------------------------------------------- */

/* Буферы для работы с изображением. */
#if defined(CONFIG_ESP32_TRUE)
    // Для ESP32 буфер следует разместить во внешнюю PSRAM.
    static uint8_t buf_out[SHARED_FRAME_BUF_SIZE]
        __attribute__((aligned(4)))
        Z_GENERIC_SECTION(.ext_ram.bss);

    // Уменьшенное изображение для входа модели (RGB24, 32x32).
    static uint8_t buf_downsample[TFLM_INPUT_SIZE]
        __attribute__((aligned(4)))
        Z_GENERIC_SECTION(.ext_ram.bss);

    uint8_t buf_processing[CONFIG_VIDEO_FRAME_WIDTH * CONFIG_VIDEO_FRAME_HEIGHT * 3]
        __attribute__((aligned(4)))
        Z_GENERIC_SECTION(.ext_ram.bss);
#endif /* CONFIG_ESP32_TRUE */
#if defined(CONFIG_STM32_TRUE)
    static uint8_t buf_out[SHARED_FRAME_BUF_SIZE];

    static uint8_t buf_downsample[TFLM_INPUT_SIZE];

    uint8_t buf_processing[CONFIG_VIDEO_FRAME_WIDTH * CONFIG_VIDEO_FRAME_HEIGHT * 3];
#endif /* CONFIG_STM32_TRUE */

// Флаг дающий понять что процесс обработки кадра завершён.
atomic_t frame_processing_is_done = ATOMIC_INIT(1);

// Семафор ожидающий новый кадр из main.
K_SEM_DEFINE(allowed_2_process, 0, 1);

/* Структура libmpix, описывающая формат изображения. */
struct mpix_format my_fmt;

/* ------------------------------------------------------------------------------------------------- */
/*                                   Поток обработки изображения                                      */
/* ------------------------------------------------------------------------------------------------- */

/* Рисует одну детекцию: рамку (4 линии) и подпись "Класс NN%".
 * Координаты det_t нормированы на кадр 32x32, полученный из ВСЕГО кадра камеры (subsample без кропа),
 * поэтому масштабирование на CONFIG_VIDEO_FRAME_WIDTH x HEIGHT линейно, без смещений. */
static void draw_detection(struct custom_mpix_canvas *canvas, const det_t *d)
{
	const int W = CONFIG_VIDEO_FRAME_WIDTH;
	const int H = CONFIG_VIDEO_FRAME_HEIGHT;

	int x1 = (int)(d->x1 * (float)W + 0.5f);
	int y1 = (int)(d->y1 * (float)H + 0.5f);
	int x2 = (int)(d->x2 * (float)W + 0.5f);
	int y2 = (int)(d->y2 * (float)H + 0.5f);

	/* Жёсткий клип: функции рисования могут не проверять границы буфера. */
	x1 = CLAMP(x1, 0, W - 2);
	y1 = CLAMP(y1, 0, H - 2);
	x2 = CLAMP(x2, x1 + 1, W);
	y2 = CLAMP(y2, y1 + 1, H);

	const int w = x2 - x1;
	const int h = y2 - y1;
	const int t = (w >= 2 * BBOX_THICKNESS && h >= 2 * BBOX_THICKNESS) ? BBOX_THICKNESS : 1;

	custom_mpix_draw_hline(canvas, x1, y1, w, t, DET_COLOR(d->label));
	custom_mpix_draw_hline(canvas, x1, y2 - t, w, t, DET_COLOR(d->label));
	custom_mpix_draw_vline(canvas, x1, y1, h, t, DET_COLOR(d->label));
	custom_mpix_draw_vline(canvas, x2 - t, y1, h, t, DET_COLOR(d->label));

	char txt[24];
	snprintf(txt, sizeof(txt), "%s %u%%", tflm_wrapper_label(d->label),
		 (unsigned int)(d->score * 100.0f + 0.5f));

	/* Подпись над рамкой; если места сверху нет - внутри рамки у верхнего края. */
	int tx = x1 + 1;
	int ty = (y1 >= LABEL_BASELINE + 2) ? (y1 - 3) : (y1 + LABEL_BASELINE);
	const int max_tx = W - (int)strlen(txt) * LABEL_CHAR_W;

	tx = CLAMP(tx, 0, MAX(max_tx, 0));
	ty = CLAMP(ty, LABEL_BASELINE, H - 1);

	custom_mpix_draw_text(canvas, tx, ty, txt, &custom_mpix_font_freemonobold8pt_ru, DET_COLOR(d->label));
}

/* Стек: libmpix + TFLM Invoke() + логирование. 1000 байт было слишком мало.
 * Стартуем с 8 КБ, затем уточняем через thread analyzer. */
#define PROCESSING_THREAD_STACK_SIZE 8192
#define PROCESSING_THREAD_PRIORITY   7

K_THREAD_STACK_DEFINE(processing_thread_stack, PROCESSING_THREAD_STACK_SIZE);
static struct k_thread processing_thread_data;

/* Поток обработки кадра.
 * Алгоритм работы:
 *   1. Дождаться готового RGB24 кадра от main() (allowed_2_process).
 *   2. Уменьшить кадр до 32x32x3 и найти на нём объекты нейросетью-детектором (SSD, TFLM int8).
 *   3. Нарисовать рамки и подписи найденных объектов на кадре (custom_mpix_draw_*).
 *   4. Конвертировать кадр обратно в нативный формат камеры (my_fmt.fourcc).
 *   5. Отдать буфер обратно main()/следующему кадру (frame_processing_is_done = 1).
 *   6. Скопировать готовый кадр на отправку по WebSocket.
 *   7. Вывести готовый кадр на дисплей (если он задан в Device Tree). */
static void processing_thread_start(void *arg1, void *arg2, void *arg3)
{
	ARG_UNUSED(arg1);
	ARG_UNUSED(arg2);
	ARG_UNUSED(arg3);

	int ret;
	int err;

	/* Инициализация TFLM. При ошибке кадры продолжают обрабатываться без детекции. */
	bool tflm_ok = false;
	ret = tflm_wrapper_init();
	if (ret != 0) {
		LOG_ERR("tflm_wrapper_init failed: %d", ret);
	} else {
		tflm_ok = true;
	}

	/* Последние найденные объекты и счётчик кадров. */
	det_t dets[TFLM_MAX_DETECTIONS];
	int n_det = 0;
	bool have_result = false;
	uint32_t frame_counter = 0;
	uint32_t infer_counter = 0;

	/* Изображение libmpix для обработки кадра. */
	struct mpix_image img_process = {};

	/* Холст для рисования поверх RGB24-буфера. */
	struct custom_mpix_canvas canvas;

	/* Строка для вывода результата на кадр. */
	char str[64];

	/* Описание формата данных, лежащих в buf_processing —
	 * это ВСЕГДА RGB24 (CONFIG_VIDEO_FRAME_WIDTH x CONFIG_VIDEO_FRAME_HEIGHT),
	 * т.к. main() кладёт туда кадр уже сконвертированным. */
	struct mpix_format process_fmt = {
		.fourcc = MPIX_FMT_RGB24,
		.width  = CONFIG_VIDEO_FRAME_WIDTH,
		.height = CONFIG_VIDEO_FRAME_HEIGHT,
	};

	while (1) {

		/* Ждать пока main() полностью скопирует новый RGB24-кадр
		 * в buf_processing. */
		k_sem_take(&allowed_2_process, K_FOREVER);

		/* Инвалидируем D-Cache перед чтением буфера, т.к. main()
		 * писал в него из другого потока/ядра. */
		sys_cache_data_invd_range(buf_processing, FRAME_RGB24_SIZE);

		/* Рисуем поверх реального кадра. */
		if (custom_mpix_canvas_from_buf(&canvas, buf_processing,
						CONFIG_VIDEO_FRAME_WIDTH,
						CONFIG_VIDEO_FRAME_HEIGHT) != 0) {
			LOG_ERR("canvas init failed");
			atomic_set(&frame_processing_is_done, 1);
			continue;
		}

		/* ---------------------------- Детекция объектов ---------------------------- */
		if (tflm_ok && (frame_counter++ % DETECT_EVERY_N_FRAMES) == 0) {

			/* Оборачиваем RGB24-буфер в mpix_image и уменьшаем до 32x32
			 * (тем же алгоритмом, которым получен датасет). */
			mpix_image_from_buf(&img_process, buf_processing, FRAME_RGB24_SIZE, &process_fmt);

			err = mpix_image_resize_subsample(&img_process, TFLM_INPUT_W, TFLM_INPUT_H);
			if (err) {
				LOG_ERR("Failed to resize: %d", err);
				mpix_image_free(&img_process);
			} else {
				/* Записать уменьшенное изображение в buf_downsample (R,G,B). */
				err = mpix_image_to_buf(&img_process, buf_downsample,
							sizeof(buf_downsample));
				mpix_image_free(&img_process);
				if (err) {
					LOG_ERR("Failed to write buf_downsample: %d", err);
				} else {
					/* Invoke() + декодирование + NMS. n >= 0 - число объектов, n < 0 - ошибка. */
					int n = tflm_wrapper_detect(buf_downsample, dets, TFLM_MAX_DETECTIONS);
					if (n < 0) {
						LOG_ERR("Detect failed: %d", n);
					} else {
						n_det = n;
						have_result = true;

						if ((infer_counter++ % 30) == 0) {
							uint32_t inv_us, post_us;
							tflm_wrapper_get_timing(&inv_us, &post_us);
							LOG_INF("det: n=%d invoke=%u us post=%u us",
								n_det, inv_us, post_us);
						}
					}
				}
			}
		}

		/* Вывод результата на кадр: рамки и подписи всех найденных объектов. */
		if (have_result) {
			for (int i = 0; i < n_det; i++) {
				draw_detection(&canvas, &dets[i]);
			}
#if SHOW_STATS
			{
				uint32_t inv_us, post_us;
				tflm_wrapper_get_timing(&inv_us, &post_us);
				snprintf(str, sizeof(str), "%d obj %u ms", n_det,
					 (unsigned int)((inv_us + post_us + 500U) / 1000U));
				custom_mpix_draw_text(&canvas, 1, CONFIG_VIDEO_FRAME_HEIGHT - 3, str,
						      &custom_mpix_font_freemonobold12pt_ru,
						      CUSTOM_MPIX_COLOR_WHITE);
			}
#endif
		}

		/* Оборачиваем модифицированный RGB24-буфер в mpix_image,
		 * чтобы сконвертировать его обратно в нативный формат камеры/дисплея. */
		mpix_image_from_buf(&img_process, buf_processing, FRAME_RGB24_SIZE, &process_fmt);

		err = mpix_image_convert(&img_process, my_fmt.fourcc);
		if (err) {
			LOG_ERR("Failed to convert back to original format: %d", err);
			mpix_image_free(&img_process);
			atomic_set(&frame_processing_is_done, 1);
			continue;
		}

		/* Забираем итоговый кадр в buf_out. */
		err = mpix_image_to_buf(&img_process, buf_out, sizeof(buf_out));
		mpix_image_free(&img_process);
		if (err) {
			LOG_ERR("Failed to write to buf_out: %d", err);
			atomic_set(&frame_processing_is_done, 1);
			continue;
		}

		/* buf_processing нам больше не нужен — освобождаем
		 * его для main(), чтобы захват следующего кадра не простаивал. */
		atomic_set(&frame_processing_is_done, 1);

		/* Отправка обработанного кадра по WebSocket. */
		size_t copy_size = MIN(sizeof(buf_out), SHARED_FRAME_BUF_SIZE);

		// Код компилируется только при включённом через конфиг сервере в проект.
        #if defined(CONFIG_SERVER_TRUE)
			/* Если предыдущий кадр отправлен на вебстраничку. */
			if (atomic_cas(&frame_is_sended, 1, 0)) {
				/* Копируем кадр из буфера камеры в общий буфер для сетевого потока. */
				memcpy(shared_frame_buf, buf_out, copy_size);
				// Сбрасываем кэш в RAM, чтобы сетевой стек/DMA увидел записанные нами данные.
				sys_cache_data_flush_range(shared_frame_buf, copy_size);
				// Сообщаем отправляющему потоку реальный размер кадра.
				shared_frame_bytesused = copy_size;
				//  Будим поток WebSocket: разрешаем отпраку кадра по соединению вебсокетов.
				k_sem_give(&allowed_2_send);
			}
		#endif /* CONFIG_SERVER_TRUE */

		// Код компилируется только при включённом через конфиг дисплее в проект.
        #if defined(CONFIG_DISPLAY_TRUE)
			/* Проверка дисплея (если он задан в Device Tree). */
			if (DT_HAS_CHOSEN(zephyr_display)) {
				struct video_buffer display_vbuf = {
					.buffer    = buf_out,
					.bytesused = sizeof(buf_out),
					.size      = sizeof(buf_out),
					.type      = VIDEO_BUF_TYPE_OUTPUT,
				};
				ret = app_display_frame(display_dev, &display_vbuf, &shared_fmt);
				if (ret != 0) {
					LOG_WRN("Failed to display this frame");
				}
			}
		#endif /* CONFIG_DISPLAY_TRUE */
	}
}


void processing_thread_init(void)
{
	k_thread_create(&processing_thread_data, processing_thread_stack,
			K_THREAD_STACK_SIZEOF(processing_thread_stack),
			processing_thread_start, NULL, NULL, NULL,
			PROCESSING_THREAD_PRIORITY, 0, K_NO_WAIT);
	k_thread_name_set(&processing_thread_data, "processing_thread");
}
```
